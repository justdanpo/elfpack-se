-carm
//K770_R8BC004
-Z(CODE)START,CODE,DATA_C,INITTAB=45D20000-45D2FFFF

-Z(CODE)PATCH_SWI=44433EEC-44433EF4
-Z(CODE)LIB=45D30000-45D34000

// инициализация списков
-Z(CODE)PATCH_STANDBY_CALL=453F7758-453F775F

// change keyhandler
-Z(CODE)PATCH_KEYHANDLER1=4548C3B8-4548C3BF
-Z(CODE)PATCH_KEYHANDLER2=4548C814-4548C81B
-Z(CODE)PATCH_KEYHANDLER3=4548C92C-4548C933
-Z(CODE)PATCH_KEYHANDLER4=4548C460-4548C467

// ассоциация elf
-Z(CODE)PATCH_DB1=44FEDAB4-44FEDABB
-Z(CODE)PATCH_DB2=44FED8A0-44FED8A7
-Z(CODE)PATCH_DB3=44FED71C-44FED723
-Z(CODE)PATCH_DB4=44FEE108-44FEE10F

// инициализация KbdHookList, Helper, Daemons
-Z(CODE)PATCH_AUTO_RUN=45CCB980-45CCB983
-Z(CODE)PATCH_AUTO_RUN1=45CCB984-45CCB987

//OseHook
-Z(CODE)PATCH_MMI_MESSAGE_HOOK=448EF408-448EF40F

// PageActionHook
-Z(CODE)PATCH_PageActionImpl_All=453E3890-453E3897
-Z(CODE)PATCH_PageActionImpl_EnterExit=453E42CC-453E42D3

// TabMenuBar check
-Z(CODE)PATCH_TabMenuCheck=4549AD34-4549AD3B

//elfpackdata
-Z(CODE)EPD=2005A458-2005A45B
