-carm
//W810_R4DB005
-Z(CODE)START,CODE,DATA_C,INITTAB=456B8000-456BFFFF

-Z(CODE)PATCH_SWI=441898A4-441898AB
-Z(CODE)LIB=456C0000-456C4000

// change keyhandler
-Z(CODE)PATCH_KEYHANDLER1=452F94F8-452F94FF
-Z(CODE)PATCH_KEYHANDLER2=452F9B98-452F9B9F
-Z(CODE)PATCH_KEYHANDLER3=452F9D1C-452F9D23
-Z(CODE)PATCH_KEYHANDLER1_STACK1=452F9414
-Z(CODE)PATCH_KEYHANDLER1_STACK2=452F95CC
-Z(CODE)PATCH_KEYHANDLER1_CHANGE1=452F9544
-Z(CODE)PATCH_KEYHANDLER1_CHANGE2=452F9580
-Z(CODE)PATCH_KEYHANDLER1_CHANGE3=452F9590
-Z(CODE)PATCH_KEYHANDLER1_CHANGE4=452F95C6

// ассоциация elf
-Z(CODE)PATCH_DB2=455B0308-455B030B
-Z(CODE)PATCH_DB1=455B0416-455B0419

// инициализация списков
// инициализация KbdHookList, Helper, Daemons
-Z(CODE)PATCH_AUTO_RUN=44560170-44560173
-Z(CODE)PATCH_AUTO_RUN1=44560174-44560177

//OseHook
-Z(CODE)PATCH_MMI_MESSAGE_HOOK=44CF1984-44CF198D

// PageActionHook
-Z(CODE)PATCH_PageActionImpl_All=455264D4-455264DB
-Z(CODE)PATCH_PageActionImpl_EnterExit=45295744-4529574B

// TabMenuBar check
-Z(CODE)PATCH_TabMenuCheck=45148C70-45148C77

//elfpackdata
-Z(CODE)EPD=4C0700D0-4C0700D3
