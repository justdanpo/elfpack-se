-carm
//W580_R8BE001
-Z(CODE)START,CODE,DATA_C,INITTAB=45C30000-45C3FFFF

-Z(CODE)PATCH_SWI=44307AD4-44307ADC
-Z(CODE)LIB=45C40000-45C44000

// инициализация списков
-Z(CODE)PATCH_STANDBY_CALL=452C1638-452C163F

// change keyhandler
-Z(CODE)PATCH_KEYHANDLER1=453574F0-453574F7
-Z(CODE)PATCH_KEYHANDLER2=4535794C-45357953
-Z(CODE)PATCH_KEYHANDLER3=45357A64-45357A6B
-Z(CODE)PATCH_KEYHANDLER4=45357598-4535759F

// ассоциация elf
-Z(CODE)PATCH_DB1=44EB02A8-44EB02AF
-Z(CODE)PATCH_DB2=44EB0094-44EB009B
-Z(CODE)PATCH_DB3=44EAFF10-44EAFF19
-Z(CODE)PATCH_DB4=44EB08FC-44EB0903

// инициализация KbdHookList, Helper, Daemons
-Z(CODE)PATCH_AUTO_RUN=45BAB8C0-45BAB8C3
-Z(CODE)PATCH_AUTO_RUN1=45BAB8C4-45BAB8C7

//OseHook
-Z(CODE)PATCH_MMI_MESSAGE_HOOK=447AD340-447AD347

// PageActionHook
-Z(CODE)PATCH_PageActionImpl_All=452AD730-452AD737
-Z(CODE)PATCH_PageActionImpl_EnterExit=452AE16C-452AE173

// TabMenuBar check
-Z(CODE)PATCH_TabMenuCheck=45365DA0-45365DA7

//elfpackdata
-Z(CODE)EPD=2005A3E0-2005A3E3
