-carm
//C905_R1FA035
-Z(CODE)START,CODE,DATA_C,INITTAB=15DE4000-15E06FFF

-Z(CODE)PATCH_SWI=101E3BE8-101E3BEF

-Z(CODE)LIB=15DE0000-15DE3FFF

// инициализация списков
-Z(CODE)PATCH_STANDBY_CALL=14CD75CC

//OseHook
-Z(CODE)PATCH_MMI_MESSAGE_HOOK=10138164

// change keyhandler
-Z(CODE)PATCH_KEYHANDLER1=1412218C-14122193
-Z(CODE)PATCH_KEYHANDLER2=14123140-14123147
-Z(CODE)PATCH_KEYHANDLER3=142BACEC-142BACF3
-Z(CODE)PATCH_KEYHANDLER4=142BAD90-142BAD97

// инициализация KbdHookList, Helper, Daemons
-Z(CODE)PATCH_AUTO_RUN=15CBD87C
-Z(CODE)PATCH_AUTO_RUN1=15CBD880

// ассоциация elf
-Z(CODE)PATCH_DB1=14262BF0
-Z(CODE)PATCH_DB2=1407A55C
-Z(CODE)PATCH_DB3=1407B184
-Z(CODE)PATCH_DB4=14FB7918

// PageActionHook
-Z(CODE)PATCH_PageActionImpl_All=143AF504-143AF50B
-Z(CODE)PATCH_PageActionImpl_EnterExit=142BBBA8-142BBBAF

//elfpackdata
-Z(CODE)EPD=4BB0CC90-4BB0CC93
