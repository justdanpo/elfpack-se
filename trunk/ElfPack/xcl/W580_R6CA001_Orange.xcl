-carm
//W580_R6ca001_Orange
-Z(CODE)START,CODE,DATA_C,INITTAB=45CF0000-45CFFFFF

-Z(CODE)PATCH_SWI=44306EF4-44306EFB
-Z(CODE)LIB=45D00000-45D04000

// инициализация списков
-Z(CODE)PATCH_STANDBY_CALL=452EF0CC-452EF0D3

// change keyhandler
-Z(CODE)PATCH_KEYHANDLER1=45384BF0-45384BF7
-Z(CODE)PATCH_KEYHANDLER2=4538504C-45385053
-Z(CODE)PATCH_KEYHANDLER3=45385164-4538516B
-Z(CODE)PATCH_KEYHANDLER4=45384C98-45384C9F

// ассоциация elf
-Z(CODE)PATCH_DB1=44EDAA0C-44EDAA13
-Z(CODE)PATCH_DB2=44EDA7F8-44EDA7FF
-Z(CODE)PATCH_DB3=44EDA674-44EDA67D
-Z(CODE)PATCH_DB4=44EDB060-44EDB067

// инициализация KbdHookList, Helper, Daemons
-Z(CODE)PATCH_AUTO_RUN=45BAD804-45BAD807
-Z(CODE)PATCH_AUTO_RUN1=45BAD808-45BAD80B

//OseHook
-Z(CODE)PATCH_MMI_MESSAGE_HOOK=447BE61C-447BE623

// PageActionHook
-Z(CODE)PATCH_PageActionImpl_All=452DB234-452DB23B
-Z(CODE)PATCH_PageActionImpl_EnterExit=452DBC70-452DBC77

// TabMenuBar check
-Z(CODE)PATCH_TabMenuCheck=45393464-4539346B

//elfpackdata
-Z(CODE)EPD=2005A2EC-2005A2EF
