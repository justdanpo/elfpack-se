-carm
//W660_R8BB001
-Z(CODE)START,CODE,DATA_C,INITTAB=45C30000-45C3FFFF

-Z(CODE)PATCH_SWI=4442B578-4442B580
-Z(CODE)LIB=45C40000-45C44000

// инициализация списков
-Z(CODE)PATCH_STANDBY_CALL=453E9098-453E909F

// change keyhandler
-Z(CODE)PATCH_KEYHANDLER1=4547E0B0-4547E0B7
-Z(CODE)PATCH_KEYHANDLER2=4547E50C-4547E513
-Z(CODE)PATCH_KEYHANDLER3=4547E624-4547E62B
-Z(CODE)PATCH_KEYHANDLER4=4547E158-4547E15F

// ассоциация elf
-Z(CODE)PATCH_DB1=44FD9D90-44FD9D97
-Z(CODE)PATCH_DB2=44FD9B7C-44FD9B83
-Z(CODE)PATCH_DB3=44FD99F8-44FD9A01
-Z(CODE)PATCH_DB4=44FDA3E4-44FDA3EB

// инициализация KbdHookList, Helper, Daemons
-Z(CODE)PATCH_AUTO_RUN=45BD29CC-45BD29CF
-Z(CODE)PATCH_AUTO_RUN1=45BD29D0-45BD29D3

//OseHook
-Z(CODE)PATCH_MMI_MESSAGE_HOOK=448E8240-448E8247

// PageActionHook
-Z(CODE)PATCH_PageActionImpl_All=453D51D0-453D51D7
-Z(CODE)PATCH_PageActionImpl_EnterExit=453D5C0C-453D5C13

// TabMenuBar check
-Z(CODE)PATCH_TabMenuCheck=4548C9BC-4548C9C3

//elfpackdata
-Z(CODE)EPD=2005A4D0-2005A4D3
