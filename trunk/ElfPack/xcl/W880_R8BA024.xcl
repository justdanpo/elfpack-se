-carm
//W880_R8BA024
-Z(CODE)START,CODE,DATA_C,INITTAB=45D00000-45D07FFF

-Z(CODE)PATCH_SWI=4442B8A0-4442B8A7
-Z(CODE)LIB=45D08000-45D0BFFF

// инициализация списков
-Z(CODE)PATCH_STANDBY_CALL=453D9D68-453D9D6F

// change keyhandler
-Z(CODE)PATCH_KEYHANDLER1=4546EAB8-4546EABF
-Z(CODE)PATCH_KEYHANDLER2=4546EF14-4546EF1B
-Z(CODE)PATCH_KEYHANDLER3=4546F02C-4546F033
-Z(CODE)PATCH_KEYHANDLER4=4546EB60-4546EB67

// ассоциация elf
-Z(CODE)PATCH_DB1=44FD78C4-44FD78CB
-Z(CODE)PATCH_DB2=44FD76B0-44FD76B7
-Z(CODE)PATCH_DB3=44FD752C-44FD7535
-Z(CODE)PATCH_DB4=44FD7F18-44FD7F1F

// инициализация KbdHookList, Helper, Daemons
-Z(CODE)PATCH_AUTO_RUN=45CA06E8-45CA06EB
-Z(CODE)PATCH_AUTO_RUN1=45CA06EC-45CA06EF

//OseHook
-Z(CODE)PATCH_MMI_MESSAGE_HOOK=448E8568-448E856F

// PageActionHook
-Z(CODE)PATCH_PageActionImpl_All=453C5E5C-453C5E63
-Z(CODE)PATCH_PageActionImpl_EnterExit=453C6898-453C689F

// TabMenuBar check
-Z(CODE)PATCH_TabMenuCheck=4547D520-4547D527

//elfpackdata
-Z(CODE)EPD=2005A000-2005A003
