-carm
//K810_R8BA024
-Z(CODE)START,CODE,DATA_C,INITTAB=45CBB200-45CCB1FF

-Z(CODE)PATCH_SWI=4443388C-44433893
-Z(CODE)LIB=45CCB200-45CD0200

// инициализация списков
-Z(CODE)PATCH_STANDBY_CALL=453CC1F4-453CC1FB

// change keyhandler
-Z(CODE)PATCH_KEYHANDLER1=45460DA4-45460DAB
-Z(CODE)PATCH_KEYHANDLER2=45461200-45461207
-Z(CODE)PATCH_KEYHANDLER3=45461318-4546131F
-Z(CODE)PATCH_KEYHANDLER4=45460E4C-45460E53

// ассоциация elf
-Z(CODE)PATCH_DB1=44FC5ABC-44FC5AC3
-Z(CODE)PATCH_DB2=44FC58A8-44FC58AF
-Z(CODE)PATCH_DB3=44FC5724-44FC572B
-Z(CODE)PATCH_DB4=44FC6110-44FC6117

// инициализация KbdHookList, Helper, Daemons
-Z(CODE)PATCH_AUTO_RUN=45C64284-45C64287
-Z(CODE)PATCH_AUTO_RUN1=45C64288-45C6428B

//OseHook
-Z(CODE)PATCH_MMI_MESSAGE_HOOK=448FAA48-448FAA4F

// PageActionHook
-Z(CODE)PATCH_PageActionImpl_All=453B8330-453B8337
-Z(CODE)PATCH_PageActionImpl_EnterExit=453B8D6C-453B8D73

// TabMenuBar check
-Z(CODE)PATCH_TabMenuCheck=4546F638-4546F63F

//elfpackdata
-Z(CODE)EPD=2005AF84-2005AF87
