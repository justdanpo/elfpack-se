-carm
//W660_R8BB001_Orange
-Z(CODE)START,CODE,DATA_C,INITTAB=45D40000-45D4FFFF

-Z(CODE)PATCH_SWI=4442B808-4442B880
-Z(CODE)LIB=45D50000-45D54000

// инициализация списков
-Z(CODE)PATCH_STANDBY_CALL=45424A44-45424A4B

// change keyhandler
-Z(CODE)PATCH_KEYHANDLER1=454B9884-454B988B
-Z(CODE)PATCH_KEYHANDLER2=454B9CE0-454B9CE7
-Z(CODE)PATCH_KEYHANDLER3=454B9DF8-454B9DFF
-Z(CODE)PATCH_KEYHANDLER4=454B992C-454B9933

// ассоциация elf
-Z(CODE)PATCH_DB1=4500EB64-4500EB6B
-Z(CODE)PATCH_DB2=4500E950-4500E957
-Z(CODE)PATCH_DB3=4500E7CC-4500E7D5
-Z(CODE)PATCH_DB4=4500F1B8-4500F1BF

// инициализация KbdHookList, Helper, Daemons
-Z(CODE)PATCH_AUTO_RUN=45C00480-45C00483
-Z(CODE)PATCH_AUTO_RUN1=45C00484-45C00487

//OseHook
-Z(CODE)PATCH_MMI_MESSAGE_HOOK=44910C74-44910C7B

// PageActionHook
-Z(CODE)PATCH_PageActionImpl_All=45410B84-45410B8B
-Z(CODE)PATCH_PageActionImpl_EnterExit=454115C0-454115C7

// TabMenuBar check
-Z(CODE)PATCH_TabMenuCheck=454C8190-454C8197

//elfpackdata
-Z(CODE)EPD=2005A4D0-2005A4D3
