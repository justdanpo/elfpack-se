-carm
//K600_R2BB001
-Z(CODE)START,CODE,DATA_C,INITTAB=21468000-2146FFFF

-Z(CODE)PATCH_SWI=200A2354-200A235B
-Z(CODE)LIB=21470000-21473FFF

// инициализация списков
-Z(CODE)PATCH_STANDBY_CALL=20281ECC-20281ED3

// change keyhandler
-Z(CODE)PATCH_KEYHANDLER1=20264EB8-20264EBF
-Z(CODE)PATCH_KEYHANDLER2=202654AC-202654B3
-Z(CODE)PATCH_KEYHANDLER3=20265624-2026562B

// статическая рама
-Z(DATA)DATA_N=2824466C-2824466F

// ассоциация elf
-Z(CODE)PATCH_DB2=204E1FA8-204E1FAF
-Z(CODE)PATCH_DB1=204E20D4-204E20DB

// инициализация KbdHookList, Helper, Daemons
-Z(CODE)PATCH_AUTO_RUN=20F8A9BC-20F8A9BF
-Z(CODE)PATCH_AUTO_RUN1=20F8A9C0-20F8A9C3

//OseHook
-Z(CODE)PATCH_MMI_MESSAGE_HOOK=209627C0-209627C9

// PageActionHook
-Z(CODE)PATCH_PageActionImpl_All=20425B94-20425B9B
-Z(CODE)PATCH_PageActionImpl_EnterExit=2025CC2C-2025CC33

// TabMenuBar check
-Z(CODE)PATCH_TabMenuCheck=207540D4-207540DB

//elfpackdata
-Z(CODE)EPD=28052928-2805292B
