-carm

//K660_R1FA037_Hutchison
-Z(CODE)START,CODE,DATA_C,INITTAB=12194000-121B6FFF

-Z(CODE)PATCH_SWI=100F23F8-100F23FF
-Z(CODE)LIB=12190000-12193FFF

// инициализация списков
-Z(CODE)PATCH_STANDBY_CALL=1161155C-11611563

// change keyhandler
-Z(CODE)PATCH_KEYHANDLER1=1169A910-1169A917
-Z(CODE)PATCH_KEYHANDLER2=1169AD54-1169AD5B
-Z(CODE)PATCH_KEYHANDLER3=1169AE8C-1169AE93
-Z(CODE)PATCH_KEYHANDLER4=1169A9C0-1169A9C7

// ассоциация elf
-Z(CODE)PATCH_DB1=1100E12C-1100E133
-Z(CODE)PATCH_DB2=1100DF38-1100DF3F
-Z(CODE)PATCH_DB3=1100DDF8-1100DDFF
-Z(CODE)PATCH_DB4=1100E908-1100E90F
-Z(CODE)PATCH_DB5=1100DF84-1100DF8B
-Z(CODE)PATCH_DB6=1100DFB8-1100DFBF

// инициализация KbdHookList, Helper, Daemons
-Z(CODE)PATCH_AUTO_RUN=11B72004-11B72007
-Z(CODE)PATCH_AUTO_RUN1=11B72008-11B7200B

//OseHook
-Z(CODE)PATCH_MMI_MESSAGE_HOOK=107626D8-107626E1

// PageActionHook
-Z(CODE)PATCH_PageActionImpl_All=11605290-11605297
-Z(CODE)PATCH_PageActionImpl_EnterExit=11605928-1160592F

//elfpackdata
-Z(CODE)EPD=2A2570D4-2A2570D7
