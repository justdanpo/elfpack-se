-carm
//W600_R7CA017
-Z(CODE)START,CODE,DATA_C,INITTAB=45618000-4561FFFF

-Z(CODE)PATCH_SWI=440EFFCC-440EFFD3
-Z(CODE)LIB=45620000-45624000


// инициализация списков
-Z(CODE)PATCH_STANDBY_CALL=451EB5E4-451EB5EB


// change keyhandler
-Z(CODE)PATCH_KEYHANDLER1=45241D80-45241D87
-Z(CODE)PATCH_KEYHANDLER2=452423FC-45242403
-Z(CODE)PATCH_KEYHANDLER3=45242580-45242587

// ассоциация elf
-Z(CODE)PATCH_DB2=45501610-45501613
-Z(CODE)PATCH_DB1=4550171E-45501721

// инициализация KbdHookList, Helper, Daemons
-Z(CODE)PATCH_AUTO_RUN=444C353C-444C353F
-Z(CODE)PATCH_AUTO_RUN1=444C3540-444C3543

//OseHook
-Z(CODE)PATCH_MMI_MESSAGE_HOOK=44B39BE8-44B39BF1

// PageActionHook
-Z(CODE)PATCH_PageActionImpl_All=4546B888-4546B88F
-Z(CODE)PATCH_PageActionImpl_EnterExit=451DE638-451DE63F

// TabMenuBar check
-Z(CODE)PATCH_TabMenuCheck=4508DDC8-4508DDCF

//elfpackdata
-Z(CODE)EPD=4C0B7614-4C0B7617
