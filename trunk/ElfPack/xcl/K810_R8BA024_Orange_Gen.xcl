-carm
//K810_R8BA024_Orange_Gen
-Z(CODE)START,CODE,DATA_C,INITTAB=45CE3B30-45CECB2F

-Z(CODE)PATCH_SWI=44433B1C-44433B23
-Z(CODE)LIB=45CECB30-45CF0B2F

// инициализация списков
-Z(CODE)PATCH_STANDBY_CALL=45407C44-45407C4B

// change keyhandler
-Z(CODE)PATCH_KEYHANDLER1=4549C654-4549C65B
-Z(CODE)PATCH_KEYHANDLER2=4549CAB0-4549CAB7
-Z(CODE)PATCH_KEYHANDLER3=4549CBC8-4549CBCF
-Z(CODE)PATCH_KEYHANDLER4=4549C6FC-4549C703

// ассоциация elf
-Z(CODE)PATCH_DB1=44FFA908-44FFA90F
-Z(CODE)PATCH_DB2=44FFA6F4-44FFA6FB
-Z(CODE)PATCH_DB3=44FFA570-44FFA577
-Z(CODE)PATCH_DB4=44FFAF5C-44FFAF63

// инициализация KbdHookList, Helper, Daemons
-Z(CODE)PATCH_AUTO_RUN=45C94698-45C9469B
-Z(CODE)PATCH_AUTO_RUN1=45C9469C-45C9469F

//OseHook
-Z(CODE)PATCH_MMI_MESSAGE_HOOK=449234DC-449234E3

// PageActionHook
-Z(CODE)PATCH_PageActionImpl_All=453F3D70-453F3D77
-Z(CODE)PATCH_PageActionImpl_EnterExit=453F47AC-453F47B3

// TabMenuBar check
-Z(CODE)PATCH_TabMenuCheck=454AAEE0-454AAEE7

//elfpackdata
-Z(CODE)EPD=2005AF84-2005AF87
