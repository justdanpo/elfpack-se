-carm
//C702_R3EF001
-Z(CODE)START,CODE,DATA_C,INITTAB=127C9000-127EBFFF

-Z(CODE)PATCH_SWI=1017AF00-1017AF07
-Z(CODE)LIB=127C5000-127C8FFF

// инициализация списков
-Z(CODE)PATCH_STANDBY_CALL=10DFE600

// change keyhandler
-Z(CODE)PATCH_KEYHANDLER1=10A3582C-10A35833
-Z(CODE)PATCH_KEYHANDLER2=10A35C7C-10A35C83
-Z(CODE)PATCH_KEYHANDLER3=10A35DD4-10A35DDB
-Z(CODE)PATCH_KEYHANDLER4=10A358D4-10A358DB

// ассоциация elf
-Z(CODE)PATCH_DB1=11856640
-Z(CODE)PATCH_DB2=11856448
-Z(CODE)PATCH_DB3=118562F0
-Z(CODE)PATCH_DB4=11856CBC

-Z(CODE)PATCH_DB5=11856494
-Z(CODE)PATCH_DB6=118564C8

// инициализация KbdHookList, Helper, Daemons
-Z(CODE)PATCH_AUTO_RUN=11F8C4E8
-Z(CODE)PATCH_AUTO_RUN1=11F8C4EC

//OseHook
-Z(CODE)PATCH_MMI_MESSAGE_HOOK=11281A4C

// PageActionHook
-Z(CODE)PATCH_PageActionImpl_All=10E60AAC-10E60AB3
-Z(CODE)PATCH_PageActionImpl_EnterExit=10E6117C-10E61183

//elfpackdata
-Z(CODE)EPD=2AF992DC-2AF992DF
