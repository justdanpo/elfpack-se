-carm
//W550_R4CB020
-Z(CODE)START,CODE,DATA_C,INITTAB=45618000-4561FFFF//4561FFFF

-Z(CODE)PATCH_SWI=440E6724-440E672B
-Z(CODE)LIB=45620000-45624000


// инициализация списков
-Z(CODE)PATCH_STANDBY_CALL=451D4438-451D443F

// change keyhandler
-Z(CODE)PATCH_KEYHANDLER1=4522A950-4522A957
-Z(CODE)PATCH_KEYHANDLER2=4522AFCC-4522AFD3
-Z(CODE)PATCH_KEYHANDLER3=4522B150-4522B157

// ассоциация elf
-Z(CODE)PATCH_DB2=454E971C-454E971F
-Z(CODE)PATCH_DB1=454E982A-454E982D

// инициализация KbdHookList, Helper, Daemons
-Z(CODE)PATCH_AUTO_RUN=444C2D00-444C2D03
-Z(CODE)PATCH_AUTO_RUN1=444C2D04-444C2D07

//OseHook
-Z(CODE)PATCH_MMI_MESSAGE_HOOK=44B0B378-44B0B381

// PageActionHook
-Z(CODE)PATCH_PageActionImpl_All=45453F9C-45453FA3
-Z(CODE)PATCH_PageActionImpl_EnterExit=451C7488-451C748F

// TabMenuBar check
-Z(CODE)PATCH_TabMenuCheck=4507F1A0-4507F1A7

//elfpackdata
-Z(CODE)EPD=4C054E24-4C054E27
