-carm
//W700_R1CA021
-Z(CODE)START,CODE,DATA_C,INITTAB=451E0000-451E7FFF

-Z(CODE)PATCH_SWI=440670A8-440670AF
-Z(CODE)LIB=451E8000-451EC000


// change keyhandler
-Z(CODE)PATCH_KEYHANDLER1=44E90A24-44E90A2B
-Z(CODE)PATCH_KEYHANDLER2=44E91018-44E9101F
-Z(CODE)PATCH_KEYHANDLER3=44E91190-44E91197
-Z(CODE)PATCH_KEYHANDLER1_STACK1=44E90964
-Z(CODE)PATCH_KEYHANDLER1_STACK2=44E90AF6
-Z(CODE)PATCH_KEYHANDLER1_CHANGE1=44E90A6E
-Z(CODE)PATCH_KEYHANDLER1_CHANGE2=44E90AAA
-Z(CODE)PATCH_KEYHANDLER1_CHANGE3=44E90ABA
-Z(CODE)PATCH_KEYHANDLER1_CHANGE4=44E90AF0

// ассоциация elf
-Z(CODE)PATCH_DB2=450F26D0-450F26D3
-Z(CODE)PATCH_DB1=450F27F8-450F27FB

// инициализация списков
// инициализация KbdHookList, Helper, Daemons
-Z(CODE)PATCH_AUTO_RUN=4429D488-4429D48B
-Z(CODE)PATCH_AUTO_RUN1=4429D48C-4429D48F

//OseHook
-Z(CODE)PATCH_MMI_MESSAGE_HOOK=44AE3CF4-44AE3CFD

// PageActionHook
-Z(CODE)PATCH_PageActionImpl_All=45062000-45062007
-Z(CODE)PATCH_PageActionImpl_EnterExit=44E887F0-44E887F7

// TabMenuBar check
-Z(CODE)PATCH_TabMenuCheck=44D3F85C-44D3F863

//elfpackdata
-Z(CODE)EPD=4C09412C-4C09412F
