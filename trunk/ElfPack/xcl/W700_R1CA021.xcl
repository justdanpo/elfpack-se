-carm
//W700_R1CA021
-Z(CODE)START,CODE,DATA_C,INITTAB=451E0000-451E7FFF

-Z(CODE)PATCH_SWI=440670A8-440670AF
-Z(CODE)LIB=451E8000-451EC000


// инициализация списков
-Z(CODE)PATCH_STANDBY_CALL=44EAD724-44EAD72B

// change keyhandler
-Z(CODE)PATCH_KEYHANDLER1=44E90A24-44E90A2B
-Z(CODE)PATCH_KEYHANDLER2=44E91018-44E9101F
-Z(CODE)PATCH_KEYHANDLER3=44E91190-44E91197

// ассоциация elf
-Z(CODE)PATCH_DB2=450F26D0-450F26D3
-Z(CODE)PATCH_DB1=450F27F8-450F27FB

// инициализация KbdHookList, Helper, Daemons
-Z(CODE)PATCH_AUTO_RUN=4429D488-4429D48B
-Z(CODE)PATCH_AUTO_RUN1=4429D48C-4429D48F

//OseHook
-Z(CODE)PATCH_MMI_MESSAGE_HOOK=44AE3CF4-44AE3CFD

// PageActionHook
-Z(CODE)PATCH_PageActionImpl_All=45062000-45062007
-Z(CODE)PATCH_PageActionImpl_EnterExit=44E887F0-44E887F7

// TabMenuBar check
-Z(CODE)PATCH_TabMenuCheck=44D3F85C-44D3F863

//elfpackdata
-Z(CODE)EPD=4C09412C-4C09412F
