-carm
//W300_R4EA031
-Z(CODE)START,CODE,DATA_C,INITTAB=45675000-4567CFFF

-Z(CODE)PATCH_SWI=4418E0DC-4418E0E3
-Z(CODE)LIB=4567D000-45681000


// инициализация списков
-Z(CODE)PATCH_STANDBY_CALL=452344C8-452344CF

// change keyhandler
-Z(CODE)PATCH_KEYHANDLER1=4528B5E8-4528B5EF
-Z(CODE)PATCH_KEYHANDLER2=4528BCA0-4528BCA7
-Z(CODE)PATCH_KEYHANDLER3=4528BE24-4528BE2B

// ассоциация elf
-Z(CODE)PATCH_DB2=455432E0-455432E3
-Z(CODE)PATCH_DB1=455433EE-455433F1

// инициализация KbdHookList, Helper, Daemons
-Z(CODE)PATCH_AUTO_RUN=445642BC-445642BF
-Z(CODE)PATCH_AUTO_RUN1=445642C0-445642C3

//OseHook
-Z(CODE)PATCH_MMI_MESSAGE_HOOK=44B72E08-44B72E11

// PageActionHook
-Z(CODE)PATCH_PageActionImpl_All=454B88A4-454B88AB
-Z(CODE)PATCH_PageActionImpl_EnterExit=452279E0-452279E7

// TabMenuBar check
-Z(CODE)PATCH_TabMenuCheck=450DB130-450DB137

//elfpackdata
-Z(CODE)EPD=4C0B7A1C-4C0B7A1F
