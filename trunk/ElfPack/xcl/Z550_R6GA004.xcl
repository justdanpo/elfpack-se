-carm
//Z550_R6GA004
-Z(CODE)START,CODE,DATA_C,INITTAB=456B8000-456BFFFF

-Z(CODE)PATCH_SWI=4418269C-441826A3
-Z(CODE)LIB=456C0000-456C4000


// инициализация списков
-Z(CODE)PATCH_STANDBY_CALL=452677F4-452677FB

// change keyhandler
-Z(CODE)PATCH_KEYHANDLER1=452BE5AC-452BE5B3
-Z(CODE)PATCH_KEYHANDLER2=452BEC64-452BEC6B
-Z(CODE)PATCH_KEYHANDLER3=452BEDE8-452BEDEF

// ассоциация elf
-Z(CODE)PATCH_DB2=4556EB80-4556EB83
-Z(CODE)PATCH_DB1=4556EC8E-4556EC91

// инициализация KbdHookList, Helper, Daemons
-Z(CODE)PATCH_AUTO_RUN=4455906C-4455906F
-Z(CODE)PATCH_AUTO_RUN1=44559070-44559073

//OseHook
-Z(CODE)PATCH_MMI_MESSAGE_HOOK=44B8B278-44B8B281

// PageActionHook
-Z(CODE)PATCH_PageActionImpl_All=454E5194-454E519B
-Z(CODE)PATCH_PageActionImpl_EnterExit=4525AFD8-4525AFDF

// TabMenuBar check
-Z(CODE)PATCH_TabMenuCheck=451105DC

//elfpackdata
-Z(CODE)EPD=4C065C14-4C065C17
