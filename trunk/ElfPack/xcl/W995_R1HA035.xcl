-carm
//W995_R1HA035
-Z(CODE)START,CODE,DATA_C,INITTAB=15E2EF00-15E51EFF

-Z(CODE)PATCH_SWI=101E27C4-101E27CB
-Z(CODE)LIB=15E2AF00-15E2EEFF

// инициализация списков
-Z(CODE)PATCH_STANDBY_CALL=14E30C94-14E30C9B

// change keyhandler
-Z(CODE)PATCH_KEYHANDLER1=141067C4-141067CB
-Z(CODE)PATCH_KEYHANDLER2=14106EB0-14106EB7
-Z(CODE)PATCH_KEYHANDLER3=14106B8C-14106B93
-Z(CODE)PATCH_KEYHANDLER4=14106C30-14106C37

// ассоциация elf
-Z(CODE)PATCH_DB1=142DBA94
-Z(CODE)PATCH_DB2=142DBE8C
-Z(CODE)PATCH_DB3=14FC8030
-Z(CODE)PATCH_DB4=14FF113C


// инициализация KbdHookList, Helper, Daemons
-Z(CODE)PATCH_AUTO_RUN=15D14708-15D1470B
-Z(CODE)PATCH_AUTO_RUN1=15D1470C-15D1470F

//OseHook
-Z(CODE)PATCH_MMI_MESSAGE_HOOK=10137520-10137527

// PageActionHook
-Z(CODE)PATCH_PageActionImpl_All=14103EE0-14103EE7
-Z(CODE)PATCH_PageActionImpl_EnterExit=140458E4-140458EB

//elfpackdata
-Z(CODE)EPD=4BB0D17C-4BB0D17F