-carm
//W810_R4EA031
-Z(CODE)START,CODE,DATA_C,INITTAB=456B8000-456BFFFF//456BFFFF

-Z(CODE)PATCH_SWI=4418BBDC-4418BBE3
-Z(CODE)LIB=456C0000-456C4000


// инициализация списков
-Z(CODE)PATCH_STANDBY_CALL=452AC494-452AC49B

// change keyhandler
-Z(CODE)PATCH_KEYHANDLER1=45303220-45303227
-Z(CODE)PATCH_KEYHANDLER2=453038C0-453038C7
-Z(CODE)PATCH_KEYHANDLER3=45303A44-45303A4B
-Z(CODE)PATCH_KEYHANDLER1_STACK1=4530313C
-Z(CODE)PATCH_KEYHANDLER1_STACK2=453032F4
-Z(CODE)PATCH_KEYHANDLER1_CHANGE1=4530326C
-Z(CODE)PATCH_KEYHANDLER1_CHANGE2=453032A8
-Z(CODE)PATCH_KEYHANDLER1_CHANGE3=453032B8
-Z(CODE)PATCH_KEYHANDLER1_CHANGE4=453032EE

// ассоциация elf
-Z(CODE)PATCH_DB2=455BAE48-455BAE4B
-Z(CODE)PATCH_DB1=455BAF56-455BAF59

// инициализация KbdHookList, Helper, Daemons
-Z(CODE)PATCH_AUTO_RUN=44564944-44564947
-Z(CODE)PATCH_AUTO_RUN1=44564948-4456494B

//OseHook
-Z(CODE)PATCH_MMI_MESSAGE_HOOK=44C1B034-44C1B03D

// PageActionHook
-Z(CODE)PATCH_PageActionImpl_All=45530FB0-45530FB7
-Z(CODE)PATCH_PageActionImpl_EnterExit=4529F474-4529F47B

// TabMenuBar check
-Z(CODE)PATCH_TabMenuCheck=45153804-4515380B

//elfpackdata
-Z(CODE)EPD=4C055894-4C055897
