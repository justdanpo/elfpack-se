//K610_R8BE001
-carm
-Z(CODE)START,CODE,DATA_C,INITTAB=45D10000-45D1FFFF

-Z(CODE)PATCH_SWI=4442AA58-4442AA5F
-Z(CODE)LIB=45D20000-45D25000

// change keyhandler
-Z(CODE)PATCH_KEYHANDLER1=4542BD74-4542BD7B
-Z(CODE)PATCH_KEYHANDLER2=4542C1D0-4542C1D7
-Z(CODE)PATCH_KEYHANDLER3=4542C2E8-4542C2EF
-Z(CODE)PATCH_KEYHANDLER1_STACK1=4542BC7E
-Z(CODE)PATCH_KEYHANDLER1_STACK2=4542BE5E
-Z(CODE)PATCH_KEYHANDLER1_CHANGE1=4542BDBA
-Z(CODE)PATCH_KEYHANDLER1_CHANGE2=4542BDF6
-Z(CODE)PATCH_KEYHANDLER1_CHANGE3=4542BE28
-Z(CODE)PATCH_KEYHANDLER1_CHANGE4=4542BE58

// elf file association
-Z(CODE)PATCH_DB1=44FA5B00-44FA5B07
-Z(CODE)PATCH_DB2=44FA58EC-44FA58F3
-Z(CODE)PATCH_DB3=44FA5768-44FA576F
-Z(CODE)PATCH_DB4=44FA6154-44FA615B

// lists initialization
// initialization of KbdHookList, Helper, Daemons
-Z(CODE)PATCH_AUTO_RUN=45B363E0-45B363E3
-Z(CODE)PATCH_AUTO_RUN1=45B363E4-45B363E7

//OseHook
-Z(CODE)PATCH_MMI_MESSAGE_HOOK=448E6210-448E6217

// PageActionHook
-Z(CODE)PATCH_PageActionImpl_All=45383508-4538350F
-Z(CODE)PATCH_PageActionImpl_EnterExit=45383F44-45383F4B

// TabMenuBar check
-Z(CODE)PATCH_TabMenuCheck=4543A594-4543A59B

//elfpackdata
-Z(CODE)EPD=20059618-2005961B
