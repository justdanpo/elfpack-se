//T715_R1GA026
-carm
-Z(CODE)START,CODE,DATA_C,INITTAB=15CE8000-15CEFFFF

-Z(CODE)PATCH_SWI=101CB468-101CB46F
-Z(CODE)LIB=15CE4000-15CE7FFF


// change keyhandler
-Z(CODE)PATCH_KEYHANDLER1=1410570C-14105713
-Z(CODE)PATCH_KEYHANDLER2=14105DF8-14105DFF
-Z(CODE)PATCH_KEYHANDLER3=14105AD4-14105ADB
-Z(CODE)PATCH_KEYHANDLER3_NOP=14105B02
-Z(CODE)PATCH_KEYHANDLER3_CHANGE1=14105B88
-Z(CODE)PATCH_KEYHANDLER3_CHANGE2=14105BC2

// elf file association
-Z(CODE)PATCH_DB1=142D9088-142D908F
-Z(CODE)PATCH_DB2=142D9480-142D9487
-Z(CODE)PATCH_DB3=14F00094-14F0009B
-Z(CODE)PATCH_DB4=14F28884-14F2888B

// lists initialization
// initialization of KbdHookList, Helper, Daemons
-Z(CODE)PATCH_AUTO_RUN=15B10978-15B1097B
-Z(CODE)PATCH_AUTO_RUN1=15B1097C-15B1097F

//OseHook
-Z(CODE)PATCH_MMI_MESSAGE_HOOK=10129088-1012908F

// PageActionHook
-Z(CODE)PATCH_PageActionImpl_All=14102E04-14102E0B
-Z(CODE)PATCH_PageActionImpl_EnterExit=140451CC-140451D3

//elfpackdata
-Z(CODE)EPD=4BB046D8-4BB046DB