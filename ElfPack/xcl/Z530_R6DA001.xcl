-carm
//Z530_R6DA001
-Z(CODE)START,CODE,DATA_C,INITTAB=456B8000-456BFFFF

-Z(CODE)PATCH_SWI=4418449C-441844A3
-Z(CODE)LIB=456C0000-456C4000


// change keyhandler
-Z(CODE)PATCH_KEYHANDLER1=452331A4-452331AB
-Z(CODE)PATCH_KEYHANDLER2=4523385C-45233863
-Z(CODE)PATCH_KEYHANDLER3=452339E0-452339E7
-Z(CODE)PATCH_KEYHANDLER1_STACK1=452330C0
-Z(CODE)PATCH_KEYHANDLER1_STACK2=45233278
-Z(CODE)PATCH_KEYHANDLER1_CHANGE1=452331F0
-Z(CODE)PATCH_KEYHANDLER1_CHANGE2=4523322C
-Z(CODE)PATCH_KEYHANDLER1_CHANGE3=4523323C
-Z(CODE)PATCH_KEYHANDLER1_CHANGE4=45233272

// elf file association
-Z(CODE)PATCH_DB2=454D1B68-454D1B6B
-Z(CODE)PATCH_DB1=454D1C76-454D1C79

// lists initialization
// initialization of KbdHookList, Helper, Daemons
-Z(CODE)PATCH_AUTO_RUN=44555758-4455575B
-Z(CODE)PATCH_AUTO_RUN1=4455575C-4455575F

//OseHook
-Z(CODE)PATCH_MMI_MESSAGE_HOOK=44B16078-44B16081

// PageActionHook
-Z(CODE)PATCH_PageActionImpl_All=45454110
-Z(CODE)PATCH_PageActionImpl_EnterExit=451CFE64-451CFE6B

// TabMenuBar check
-Z(CODE)PATCH_TabMenuCheck=450885D8-450885DF

//elfpackdata
-Z(CODE)EPD=4C06DA80-4C06DA83
