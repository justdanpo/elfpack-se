-carm
//W610_R6BC002
-Z(CODE)START,CODE,DATA_C,INITTAB=45C30000-45C3FFFF

-Z(CODE)PATCH_SWI=4430C5A8-4430C5B0
-Z(CODE)LIB=45C40000-45C44000

// инициализация списков
-Z(CODE)PATCH_STANDBY_CALL=452B89BC-452B89C3

// change keyhandler
-Z(CODE)PATCH_KEYHANDLER1=4534D9C4-4534D9CB
-Z(CODE)PATCH_KEYHANDLER2=4534DE20-4534DE27
-Z(CODE)PATCH_KEYHANDLER3=4534DF38-4534DF3F
-Z(CODE)PATCH_KEYHANDLER4=4534DA6C-4534DA73

// ассоциация elf
-Z(CODE)PATCH_DB1=44EB785C-44EB7863
-Z(CODE)PATCH_DB2=44EB7648-44EB764F
-Z(CODE)PATCH_DB3=44EB74C4-44EB74CD
-Z(CODE)PATCH_DB4=44EB7EB0-44EB7EB7

// инициализация KbdHookList, Helper, Daemons
-Z(CODE)PATCH_AUTO_RUN=45A46BA0-45A46BA3
-Z(CODE)PATCH_AUTO_RUN1=45A46BA4-45A46BA7

//OseHook
-Z(CODE)PATCH_MMI_MESSAGE_HOOK=447AC63C-447AC643

// PageActionHook
-Z(CODE)PATCH_PageActionImpl_All=452A4D20-452A4D27
-Z(CODE)PATCH_PageActionImpl_EnterExit=452A575C-452A5763

// TabMenuBar check
-Z(CODE)PATCH_TabMenuCheck=4535C29C-4535C2A3

//elfpackdata
-Z(CODE)EPD=2005B4C0-2005B4C3
