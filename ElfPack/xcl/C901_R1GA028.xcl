-carm
//C901_R1GA028
-Z(CODE)START,CODE,DATA_C,INITTAB=15D8D000-15DAFFFF

-Z(CODE)PATCH_SWI=101CB5AC-101CB5B3

-Z(CODE)LIB=15D89000-15D8CFFF

//OseHook
-Z(CODE)PATCH_MMI_MESSAGE_HOOK=10128FB0

// change keyhandler
-Z(CODE)PATCH_KEYHANDLER1=14105B54-14105B5B
-Z(CODE)PATCH_KEYHANDLER2=14106240-14106247
-Z(CODE)PATCH_KEYHANDLER3=14105F1C-14105F23
-Z(CODE)PATCH_KEYHANDLER3_NOP=14105F4A
-Z(CODE)PATCH_KEYHANDLER3_CHANGE1=14105FD0
-Z(CODE)PATCH_KEYHANDLER3_CHANGE2=1410600A

// lists initialization
// initialization of KbdHookList, Helper, Daemons
-Z(CODE)PATCH_AUTO_RUN=15BD40B0
-Z(CODE)PATCH_AUTO_RUN1=15BD40B4

// elf file association
-Z(CODE)PATCH_DB1=142DA980
-Z(CODE)PATCH_DB2=142DA588
-Z(CODE)PATCH_DB3=14F349FC
-Z(CODE)PATCH_DB4=14F0BEAC

// PageActionHook
-Z(CODE)PATCH_PageActionImpl_All=1410328C-14103293
-Z(CODE)PATCH_PageActionImpl_EnterExit=14045500-14045507

//elfpackdata
-Z(CODE)EPD=4BAFFB40-4BAFFB43
