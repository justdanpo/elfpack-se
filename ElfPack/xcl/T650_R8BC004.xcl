-carm
//T650_R8BC004
-Z(CODE)START,CODE,DATA_C,INITTAB=45D20000-45D2FFFF

-Z(CODE)PATCH_SWI=44433DE4-44433DEB
-Z(CODE)LIB=45D30000-45D34000

// change keyhandler
-Z(CODE)PATCH_KEYHANDLER1=454899C0-454899C7
-Z(CODE)PATCH_KEYHANDLER2=45489E1C-45489E23
-Z(CODE)PATCH_KEYHANDLER3=45489F34-45489F3B
-Z(CODE)PATCH_KEYHANDLER1_STACK1=454898CA
-Z(CODE)PATCH_KEYHANDLER1_STACK2=45489AAA
-Z(CODE)PATCH_KEYHANDLER1_CHANGE1=45489A06
-Z(CODE)PATCH_KEYHANDLER1_CHANGE2=45489A42
-Z(CODE)PATCH_KEYHANDLER1_CHANGE3=45489A74
-Z(CODE)PATCH_KEYHANDLER1_CHANGE4=45489AA4

// elf file association
-Z(CODE)PATCH_DB1=44FED70C-44FED713
-Z(CODE)PATCH_DB2=44FED4F8-44FED4FF
-Z(CODE)PATCH_DB3=44FED374-44FED37B
-Z(CODE)PATCH_DB4=44FEDD60-44FEDD67

// lists initialization
// initialization of KbdHookList, Helper, Daemons
-Z(CODE)PATCH_AUTO_RUN=45CB97DC-45CB97DF
-Z(CODE)PATCH_AUTO_RUN1=45CB97E0-45CB97E3

//OseHook
-Z(CODE)PATCH_MMI_MESSAGE_HOOK=448EF300-448EF307

// PageActionHook
-Z(CODE)PATCH_PageActionImpl_All=453E1020-453E1027
-Z(CODE)PATCH_PageActionImpl_EnterExit=453E1A5C-453E1A63

// TabMenuBar check
-Z(CODE)PATCH_TabMenuCheck=4549833C-45498343

//elfpackdata
-Z(CODE)EPD=2005A428-2005A42B
