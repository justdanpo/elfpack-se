-carm
//W350_R11CA002
-Z(CODE)START,CODE,DATA_C,INITTAB=21ED0000-21EDFFFF

-Z(CODE)PATCH_SWI=201850C8-201850CF
-Z(CODE)LIB=21EF0000-21FF5000

// change keyhandler
-Z(CODE)PATCH_KEYHANDLER1=210F6CF8-210F6CFF
-Z(CODE)PATCH_KEYHANDLER2=210F7170-210F7177
-Z(CODE)PATCH_KEYHANDLER3=210F7288-210F728F
-Z(CODE)PATCH_KEYHANDLER1_STACK1=210F6C02
-Z(CODE)PATCH_KEYHANDLER1_STACK2=210F6DE2
-Z(CODE)PATCH_KEYHANDLER1_CHANGE1=210F6D3E
-Z(CODE)PATCH_KEYHANDLER1_CHANGE2=210F6D7A
-Z(CODE)PATCH_KEYHANDLER1_CHANGE3=210F6DAC
-Z(CODE)PATCH_KEYHANDLER1_CHANGE4=210F6DDC

// elf file association
-Z(CODE)PATCH_DB1=20CAD688-20CAD68F
-Z(CODE)PATCH_DB2=20CAD4D0-20CAD4D7
-Z(CODE)PATCH_DB3=20CAD378-20CAD37F
-Z(CODE)PATCH_DB4=20CADBC4-20CADBCB

// lists initialization
// initialization of KbdHookList, Helper, Daemons
-Z(CODE)PATCH_AUTO_RUN=2179E764-2179E767
-Z(CODE)PATCH_AUTO_RUN1=2179E768-2179E76B

//OseHook
-Z(CODE)PATCH_MMI_MESSAGE_HOOK=20839B18-20839B1F

// PageActionHook
-Z(CODE)PATCH_PageActionImpl_All=210543C8-210543CF
-Z(CODE)PATCH_PageActionImpl_EnterExit=21054D90-21054D97

// TabMenuBar check
-Z(CODE)PATCH_TabMenuCheck=2110500C-21105013

//elfpackdata
-Z(CODE)EPD=4804EBB0-4804EBB3
