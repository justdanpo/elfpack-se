-carm
//Z750_R1FA030
-Z(CODE)START,CODE,DATA_C,INITTAB=12284000-1228FFFF

-Z(CODE)PATCH_SWI=100EBC84-100EBC8B
-Z(CODE)LIB=12280000-12283FFF

// change keyhandler
-Z(CODE)PATCH_KEYHANDLER1=116A470C-116A4713
-Z(CODE)PATCH_KEYHANDLER2=116A4B50-116A4B57
-Z(CODE)PATCH_KEYHANDLER3=116A4C88-116A4C8F
-Z(CODE)PATCH_KEYHANDLER1_STACK1=116A45FE
-Z(CODE)PATCH_KEYHANDLER1_STACK2=116A480C
-Z(CODE)PATCH_KEYHANDLER1_CHANGE1=116A4756
-Z(CODE)PATCH_KEYHANDLER1_CHANGE2=116A4796
-Z(CODE)PATCH_KEYHANDLER1_CHANGE3=116A47C8
-Z(CODE)PATCH_KEYHANDLER1_CHANGE4=116A4802

// elf file association
-Z(CODE)PATCH_DB1=11029DEC-11029DF3
-Z(CODE)PATCH_DB2=11029E38-11029E3F
-Z(CODE)PATCH_DB3=11029E6C-11029E73
-Z(CODE)PATCH_DB4=11029FE0-11029FE7
-Z(CODE)PATCH_DB5=11029CAC-11029CB3
-Z(CODE)PATCH_DB6=1102A7BC-1102A7C3

// lists initialization
// initialization of KbdHookList, Helper, Daemons
-Z(CODE)PATCH_AUTO_RUN=11B6FBF8-11B6FBFB
-Z(CODE)PATCH_AUTO_RUN1=11B6FBFC-11B6FBFF

//OseHook
-Z(CODE)PATCH_MMI_MESSAGE_HOOK=1075AFCC-1075AFD3

// PageActionHook
-Z(CODE)PATCH_PageActionImpl_All=1160E00C-1160E013
-Z(CODE)PATCH_PageActionImpl_EnterExit=1160E6A4-1160E6AB

//elfpackdata
-Z(CODE)EPD=2A250948-2A25094B
