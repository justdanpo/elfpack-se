-carm
//S500_R8BE001
-Z(CODE)START,CODE,DATA_C,INITTAB=45C30000-45C3FFFF

-Z(CODE)PATCH_SWI=44307234-4430723C
-Z(CODE)LIB=45C40000-45C44000

// change keyhandler
-Z(CODE)PATCH_KEYHANDLER1=4532E7B4-4532E7BB
-Z(CODE)PATCH_KEYHANDLER2=4532EC10-4532EC17
-Z(CODE)PATCH_KEYHANDLER3=4532ED28-4532ED2F
-Z(CODE)PATCH_KEYHANDLER1_STACK1=4532E6BE
-Z(CODE)PATCH_KEYHANDLER1_STACK2=4532E89E
-Z(CODE)PATCH_KEYHANDLER1_CHANGE1=4532E7FA
-Z(CODE)PATCH_KEYHANDLER1_CHANGE2=4532E836
-Z(CODE)PATCH_KEYHANDLER1_CHANGE3=4532E868
-Z(CODE)PATCH_KEYHANDLER1_CHANGE4=4532E898

// elf file association
-Z(CODE)PATCH_DB1=44EAA9A0-44EAA9A7
-Z(CODE)PATCH_DB2=44EAA78C-44EAA793
-Z(CODE)PATCH_DB3=44EAA608-44EAA612
-Z(CODE)PATCH_DB4=44EAAFF4-44EAAFFB

// lists initialization
// initialization of KbdHookList, Helper, Daemons
-Z(CODE)PATCH_AUTO_RUN=45B4F690-45B4F693
-Z(CODE)PATCH_AUTO_RUN1=45B4F694-45B4F697

//OseHook
-Z(CODE)PATCH_MMI_MESSAGE_HOOK=447ACAA0-447ACAA7

// PageActionHook
-Z(CODE)PATCH_PageActionImpl_All=452852D4-452852DB
-Z(CODE)PATCH_PageActionImpl_EnterExit=45285D10-45285D17

// TabMenuBar check
-Z(CODE)PATCH_TabMenuCheck=4533CFA8-4533CFAF

//elfpackdata
-Z(CODE)EPD=20059B40-20059B43
