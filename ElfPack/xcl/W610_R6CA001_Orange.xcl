-carm
//W610_R6CA001_Orange
-Z(CODE)START,CODE,DATA_C,INITTAB=45C30000-45C3FFFF

-Z(CODE)PATCH_SWI=4430C9F0-4430C9F8
-Z(CODE)LIB=45C40000-45C44000

// инициализация списков
-Z(CODE)PATCH_STANDBY_CALL=452EDC18-452EDC1F

// change keyhandler
-Z(CODE)PATCH_KEYHANDLER1=45382A24-45382A2B
-Z(CODE)PATCH_KEYHANDLER2=45382E80-45382E87
-Z(CODE)PATCH_KEYHANDLER3=45382F98-45382F9F
-Z(CODE)PATCH_KEYHANDLER4=45382ACC-45382AD3

// ассоциация elf
-Z(CODE)PATCH_DB1=44EE7B24-44EE7B2B
-Z(CODE)PATCH_DB2=44EE7910-44EE7917
-Z(CODE)PATCH_DB3=44EE778C-44EE7793
-Z(CODE)PATCH_DB4=44EE8178-44EE817F

// инициализация KbdHookList, Helper, Daemons
-Z(CODE)PATCH_AUTO_RUN=45A70C94-45A70C97
-Z(CODE)PATCH_AUTO_RUN1=45A70C98-45A70C9B

//OseHook
-Z(CODE)PATCH_MMI_MESSAGE_HOOK=447CDD74-447CDD7B

// PageActionHook
-Z(CODE)PATCH_PageActionImpl_All=452D9F74-452D9F7B
-Z(CODE)PATCH_PageActionImpl_EnterExit=452DA9B0-452DA9B7

// TabMenuBar check
-Z(CODE)PATCH_TabMenuCheck=453912F4-453912FB

//elfpackdata
-Z(CODE)EPD=2005B4C0-2005B4C3
