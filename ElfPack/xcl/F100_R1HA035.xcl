-carm
//F100_R1HA035
-Z(CODE)START,CODE,DATA_C,INITTAB=15CB8000-15CBFFFF

-Z(CODE)PATCH_SWI=101E7368-101E736F
-Z(CODE)LIB=15CB4000-15CB7FFF

// change keyhandler
-Z(CODE)PATCH_KEYHANDLER1=142ED544-142ED54B
-Z(CODE)PATCH_KEYHANDLER2=14466A38-14466A3F
-Z(CODE)PATCH_KEYHANDLER3=142ED0FC-142ED103
-Z(CODE)PATCH_KEYHANDLER3_NOP=142ED12A
-Z(CODE)PATCH_KEYHANDLER3_CHANGE1=142ED1B0
-Z(CODE)PATCH_KEYHANDLER3_CHANGE2=142ED1EA

// elf file association
-Z(CODE)PATCH_DB1=144DFCD8-144DFCDF
-Z(CODE)PATCH_DB2=144DF8E4-144DF8EB
-Z(CODE)PATCH_DB3=14F07AC4-14F07ACB
-Z(CODE)PATCH_DB4=144273CC-144273D3

// lists initialization
// initialization of KbdHookList, Helper, Daemons
-Z(CODE)PATCH_AUTO_RUN=15B14528-15B1452B
-Z(CODE)PATCH_AUTO_RUN1=15B1452C-15B1452F

//OseHook
-Z(CODE)PATCH_MMI_MESSAGE_HOOK=10134310-10134317

// PageActionHook
-Z(CODE)PATCH_PageActionImpl_All=14027114-1402711B
-Z(CODE)PATCH_PageActionImpl_EnterExit=14027380-14027387

//elfpackdata
-Z(CODE)EPD=4BB052D4-4BB052D7
