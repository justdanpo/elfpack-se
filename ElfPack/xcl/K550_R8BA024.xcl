-carm
//K550_R8BA024
-Z(CODE)START,CODE,DATA_C,INITTAB=45A40000-45A4FFFF

-Z(CODE)PATCH_SWI=4430C914-4430C91B
-Z(CODE)LIB=45A50000-45A55000

// change keyhandler
-Z(CODE)PATCH_KEYHANDLER1=4531B5B0-4531B5B7
-Z(CODE)PATCH_KEYHANDLER2=4531BA0C-4531BA13
-Z(CODE)PATCH_KEYHANDLER3=4531BB24-4531BB2B
-Z(CODE)PATCH_KEYHANDLER1_STACK1=4531B4BA
-Z(CODE)PATCH_KEYHANDLER1_STACK2=4531B69A
-Z(CODE)PATCH_KEYHANDLER1_CHANGE1=4531B5F6
-Z(CODE)PATCH_KEYHANDLER1_CHANGE2=4531B632
-Z(CODE)PATCH_KEYHANDLER1_CHANGE3=4531B664
-Z(CODE)PATCH_KEYHANDLER1_CHANGE4=4531B694

// elf file association
-Z(CODE)PATCH_DB1=44E934D4-44E934DB
-Z(CODE)PATCH_DB2=44E932C0-44E932C7
-Z(CODE)PATCH_DB3=44E9313C-44E93143
-Z(CODE)PATCH_DB4=44E93B28-44E93B2F

// lists initialization
// initialization of KbdHookList, Helper, Daemons
-Z(CODE)PATCH_AUTO_RUN=459EACCC-459EACCF
-Z(CODE)PATCH_AUTO_RUN1=459EACD0-459EACD3

//OseHook
-Z(CODE)PATCH_MMI_MESSAGE_HOOK=447C752C-447C7533

// PageActionHook
-Z(CODE)PATCH_PageActionImpl_All=45272C9C-45272CA3
-Z(CODE)PATCH_PageActionImpl_EnterExit=452736D8-452736DF

// TabMenuBar check
-Z(CODE)PATCH_TabMenuCheck=45329DDC-45329DE3

//elfpackdata
-Z(CODE)EPD=2005AC08-2005AC0B
