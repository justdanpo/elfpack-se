-carm
//C902_R3EG004AO
-Z(CODE)START,CODE,DATA_C,INITTAB=1273D000-12744FFF

-Z(CODE)PATCH_SWI=1017AEFC-1017AF03
-Z(CODE)LIB=12739000-1273CFFF

// change keyhandler
-Z(CODE)PATCH_KEYHANDLER1=109A7958-109A795F
-Z(CODE)PATCH_KEYHANDLER2=109A79A8-109A79AF
-Z(CODE)PATCH_KEYHANDLER3=109A7F00-109A7F07
-Z(CODE)PATCH_KEYHANDLER1_STACK1=109A780E
-Z(CODE)PATCH_KEYHANDLER1_STACK2=109A7A52
-Z(CODE)PATCH_KEYHANDLER1_CHANGE1=109A799E
-Z(CODE)PATCH_KEYHANDLER1_CHANGE2=109A79DC
-Z(CODE)PATCH_KEYHANDLER1_CHANGE3=109A7A0E
-Z(CODE)PATCH_KEYHANDLER1_CHANGE4=109A7A48

// elf file association
-Z(CODE)PATCH_DB1=117DC5C4-117DC5CB
-Z(CODE)PATCH_DB2=117DC3CC-117DC3D3
-Z(CODE)PATCH_DB3=117DC274-117DC27B
-Z(CODE)PATCH_DB4=117DCC40-117DCC47
-Z(CODE)PATCH_DB5=117DC418-117DC41F
-Z(CODE)PATCH_DB6=117DC44C-117DC453

// lists initialization
// initialization of KbdHookList, Helper, Daemons
-Z(CODE)PATCH_AUTO_RUN=11FB5EC0-11FB5EC3
-Z(CODE)PATCH_AUTO_RUN1=11FB5EC4-11FB5EC7

//OseHook
-Z(CODE)PATCH_MMI_MESSAGE_HOOK=11204590-11204597

// PageActionHook
-Z(CODE)PATCH_PageActionImpl_All=10DD3A10-10DD3A17
-Z(CODE)PATCH_PageActionImpl_EnterExit=10DD40E0-10DD40E7

//elfpackdata
-Z(CODE)EPD=4BBA5690-4BBA5693
