-carm
//K800_R8BF003
//-Z(CODE)START,CODE,DATA_C,INITTAB=45C9EE00-45CA5FFF
-Z(CODE)START,CODE,DATA_C,INITTAB=45D10000-45D1FFFF

-Z(CODE)PATCH_SWI=44433DA8-44433DAF
//-Z(CODE)LIB=45CA6000-45CADFFF
-Z(CODE)LIB=45D20000-45D25000

// инициализация списков
-Z(CODE)PATCH_STANDBY_CALL=453C196C-453C1973

// change keyhandler
-Z(CODE)PATCH_KEYHANDLER1=4545652C-45456533
-Z(CODE)PATCH_KEYHANDLER2=45456988-4545698F
-Z(CODE)PATCH_KEYHANDLER3=45456AA0-45456AA7
-Z(CODE)PATCH_KEYHANDLER4=454565D4-454565DB

// ассоциация elf
-Z(CODE)PATCH_DB1=44FBCEE8-44FBCEEF
-Z(CODE)PATCH_DB2=44FBCCD4-44FBCCDB
-Z(CODE)PATCH_DB3=44FBCB50-44FBCB57
-Z(CODE)PATCH_DB4=44FBD53C-44FBD543

// инициализация KbdHookList, Helper, Daemons
-Z(CODE)PATCH_AUTO_RUN=45C502EC-45C502EF
-Z(CODE)PATCH_AUTO_RUN1=45C502F0-45C502F3

//OseHook
-Z(CODE)PATCH_MMI_MESSAGE_HOOK=448E6210-448E6217

// PageActionHook
-Z(CODE)PATCH_PageActionImpl_All=453ADABC-453ADAC3
-Z(CODE)PATCH_PageActionImpl_EnterExit=453AE4F8-453AE4FF

// TabMenuBar check
-Z(CODE)PATCH_TabMenuCheck=45464D18-45464D1F

//elfpackdata
-Z(CODE)EPD=2005AF80-2005AF83
