-carm

//G502_R1FA037_Hutchison
-Z(CODE)START,CODE,DATA_C,INITTAB=12214000-12224000

-Z(CODE)PATCH_SWI=100F2400-100F2407
-Z(CODE)LIB=12210000-12213FFF

// change keyhandler
-Z(CODE)PATCH_KEYHANDLER1=1169871C-11698723
-Z(CODE)PATCH_KEYHANDLER2=11698B60-11698B67
-Z(CODE)PATCH_KEYHANDLER3=11698C98-11698C9F
-Z(CODE)PATCH_KEYHANDLER1_STACK1=1169860E
-Z(CODE)PATCH_KEYHANDLER1_STACK2=1169881C
-Z(CODE)PATCH_KEYHANDLER1_CHANGE1=11698766
-Z(CODE)PATCH_KEYHANDLER1_CHANGE2=116987A6
-Z(CODE)PATCH_KEYHANDLER1_CHANGE3=116987D8
-Z(CODE)PATCH_KEYHANDLER1_CHANGE4=11698812

// elf file association
-Z(CODE)PATCH_DB1=1100CA28-1100CA2F
-Z(CODE)PATCH_DB2=1100CA74-1100CA7B
-Z(CODE)PATCH_DB3=1100CAA8-1100CAAF
-Z(CODE)PATCH_DB4=1100CC1C-1100CC23
-Z(CODE)PATCH_DB5=1100C8E8-1100C8EF
-Z(CODE)PATCH_DB6=1100D3F8-1100D3FF

// lists initialization
// initialization of KbdHookList, Helper, Daemons
-Z(CODE)PATCH_AUTO_RUN=11B6FA84-11B6FA87
-Z(CODE)PATCH_AUTO_RUN1=11B6FA88-11B6FA8B

//OseHook
-Z(CODE)PATCH_MMI_MESSAGE_HOOK=107626DC-107626E3

// PageActionHook
-Z(CODE)PATCH_PageActionImpl_All=1160307C-11603083
-Z(CODE)PATCH_PageActionImpl_EnterExit=11603714-1160371B

//elfpackdata
-Z(CODE)EPD=2A2570DC-2A2570DF
