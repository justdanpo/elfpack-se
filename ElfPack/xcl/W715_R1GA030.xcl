-carm
//W715_R1GA030
-Z(CODE)START,CODE,DATA_C,INITTAB=15D8D000-15DAFFFF

-Z(CODE)PATCH_SWI=101E1180-101E1187
-Z(CODE)LIB=15D89000-15D8CFFF

// инициализация списков
-Z(CODE)PATCH_STANDBY_CALL=1503D380-1503D387

// change keyhandler
-Z(CODE)PATCH_KEYHANDLER1=141C9BDC-141C9BE3
-Z(CODE)PATCH_KEYHANDLER2=141C9EF0-141C9EF7
-Z(CODE)PATCH_KEYHANDLER3=144A7CCC-144A7CD3
-Z(CODE)PATCH_KEYHANDLER4=144A7D70-144A7D77

// ассоциация elf
-Z(CODE)PATCH_DB1=142CC4AC-142CC4B3
-Z(CODE)PATCH_DB2=142CCB6C-142CCB73
-Z(CODE)PATCH_DB3=14FD9BAC-14FD9BB3
-Z(CODE)PATCH_DB4=15001060-15001067


// инициализация KbdHookList, Helper, Daemons
-Z(CODE)PATCH_AUTO_RUN=15C6714C-15C6714F
-Z(CODE)PATCH_AUTO_RUN1=15C67150-15C67153

//OseHook
-Z(CODE)PATCH_MMI_MESSAGE_HOOK=1013668C-10136693

// PageActionHook
-Z(CODE)PATCH_PageActionImpl_All=14312ABC-14312AC3
-Z(CODE)PATCH_PageActionImpl_EnterExit=14489708-1448970F

//elfpackdata
-Z(CODE)EPD=4BB00FF8-4BB00FFB
