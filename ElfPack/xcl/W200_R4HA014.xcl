-carm
//W200_R4HA014
-Z(CODE)START,CODE,DATA_C,INITTAB=456B8000-456BFFFF//456BFFFF

-Z(CODE)PATCH_SWI=441824B4-441824BB
-Z(CODE)LIB=456C0000-456C4000


// инициализация списков
-Z(CODE)PATCH_STANDBY_CALL=45120544-4512054B

// change keyhandler
-Z(CODE)PATCH_KEYHANDLER1=45176F90-45176F97
-Z(CODE)PATCH_KEYHANDLER2=45177630-45177637
-Z(CODE)PATCH_KEYHANDLER3=451777B4-451777BB

// ассоциация elf
-Z(CODE)PATCH_DB2=4542D404-4542D407
-Z(CODE)PATCH_DB1=4542D512-4542D515

// инициализация KbdHookList, Helper, Daemons
-Z(CODE)PATCH_AUTO_RUN=444CB3F8-444CB3FB
-Z(CODE)PATCH_AUTO_RUN1=444CB3FC-444CB3FF

//OseHook
-Z(CODE)PATCH_MMI_MESSAGE_HOOK=44A562B8-44A562C1

// PageActionHook
-Z(CODE)PATCH_PageActionImpl_All=4539DB20-4539DB27
-Z(CODE)PATCH_PageActionImpl_EnterExit=45113538-4511353F

// TabMenuBar check
-Z(CODE)PATCH_TabMenuCheck=44FCAC4C-44FCAC53

//elfpackdata
-Z(CODE)EPD=4C063EB0-4C063EB3
