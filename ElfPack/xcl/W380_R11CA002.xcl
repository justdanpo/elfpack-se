-carm
//W380_R11CA002
-Z(CODE)START,CODE,DATA_C,INITTAB=21ED0000-21EDFFFF

-Z(CODE)PATCH_SWI=2018514C-20185153
-Z(CODE)LIB=21EF0000-21FF5000

// change keyhandler
-Z(CODE)PATCH_KEYHANDLER1=210FE4C0-210FE4C7
-Z(CODE)PATCH_KEYHANDLER2=210FE938-210FE93F
-Z(CODE)PATCH_KEYHANDLER3=210FEA50-210FEA57
-Z(CODE)PATCH_KEYHANDLER1_STACK1=210FE3CA
-Z(CODE)PATCH_KEYHANDLER1_STACK2=210FE5AA
-Z(CODE)PATCH_KEYHANDLER1_CHANGE1=210FE506
-Z(CODE)PATCH_KEYHANDLER1_CHANGE2=210FE542
-Z(CODE)PATCH_KEYHANDLER1_CHANGE3=210FE574
-Z(CODE)PATCH_KEYHANDLER1_CHANGE4=210FE5A4

// elf file association
-Z(CODE)PATCH_DB1=20CB14DC-20CB14E3
-Z(CODE)PATCH_DB2=20CB1324-20CB132B
-Z(CODE)PATCH_DB3=20CB11CC-20CB11D3
-Z(CODE)PATCH_DB4=20CB1A18-20CB1A1F

// lists initialization
// initialization of KbdHookList, Helper, Daemons
-Z(CODE)PATCH_AUTO_RUN=217AC528-217AC52B
-Z(CODE)PATCH_AUTO_RUN1=217AC52C-217AC52F

//OseHook
-Z(CODE)PATCH_MMI_MESSAGE_HOOK=2083ACCC-2083ACD3

// PageActionHook
-Z(CODE)PATCH_PageActionImpl_All=2105A9AC-2105A9B3
-Z(CODE)PATCH_PageActionImpl_EnterExit=2105B374-2105B37B

// TabMenuBar check
-Z(CODE)PATCH_TabMenuCheck=2110C8C8-2110C8CF

//elfpackdata
-Z(CODE)EPD=4804EC34-4804EC37
