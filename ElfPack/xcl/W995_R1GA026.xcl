-carm
//W995_R1GA026
-Z(CODE)START,CODE,DATA_C,INITTAB=15EC4000-15ED4000

-Z(CODE)PATCH_SWI=101E1404-101E140B // ;pAtChFiLe=/boot/phone_emp_app.cxc

-Z(CODE)LIB=15EC0000-15EC3FFF

// инициализация списков
-Z(CODE)PATCH_STANDBY_CALL=14E2EA70-14E2EA77

//OseHook
-Z(CODE)PATCH_MMI_MESSAGE_HOOK=101368C4-101368CB // ;pAtChFiLe=/boot/phone_emp_app.cxc

// change keyhandler
-Z(CODE)PATCH_KEYHANDLER1=14106620-14106627
-Z(CODE)PATCH_KEYHANDLER2=14106D0C-14106D13
-Z(CODE)PATCH_KEYHANDLER3=141069E8-141069EF
-Z(CODE)PATCH_KEYHANDLER4=14106A8C-14106A93

// инициализация KbdHookList, Helper, Daemons
-Z(CODE)PATCH_AUTO_RUN=15D0A3B0-15D0A3B3
-Z(CODE)PATCH_AUTO_RUN1=15D0A3B4-15D0A3B7

// ассоциация elf
-Z(CODE)PATCH_DB1=142DBAC4-142DBACB
-Z(CODE)PATCH_DB2=142DB6CC-142DB6D3
-Z(CODE)PATCH_DB3=14FEDCB4-14FEDCBB
-Z(CODE)PATCH_DB4=14FC5178-14FC517F

// PageActionHook
-Z(CODE)PATCH_PageActionImpl_All=14103D58-14103D5F
-Z(CODE)PATCH_PageActionImpl_EnterExit=14045670-14045677

//elfpackdata
-Z(CODE)EPD=4BB0D0E8-4BB0D0EB
