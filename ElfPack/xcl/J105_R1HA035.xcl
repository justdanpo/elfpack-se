-carm
//J105_R1HA035
-Z(CODE)START,CODE,DATA_C,INITTAB=15C8D000-15CAFFFF

-Z(CODE)PATCH_SWI=101E7364-101E736B
-Z(CODE)LIB=15C89000-15C8CFFF

// инициализация списков
-Z(CODE)PATCH_STANDBY_CALL=1444D3B8-1444D3BF

// change keyhandler
-Z(CODE)PATCH_KEYHANDLER1=142EB504-142EB50B
-Z(CODE)PATCH_KEYHANDLER2=14463664-1446366B
-Z(CODE)PATCH_KEYHANDLER3=142EB0BC-142EB0C3
-Z(CODE)PATCH_KEYHANDLER4=142EB160-142EB167

// ассоциация elf
-Z(CODE)PATCH_DB1=144DC2E8-144DC2EF
-Z(CODE)PATCH_DB2=144DBEF4-144DBEFB
-Z(CODE)PATCH_DB3=14EF8ABC-14EF8AC3
-Z(CODE)PATCH_DB4=1442437C-14424383


// инициализация KbdHookList, Helper, Daemons
-Z(CODE)PATCH_AUTO_RUN=15B00CD0-15B00CD3
-Z(CODE)PATCH_AUTO_RUN1=15B00CD4-15B00CD7

//OseHook
-Z(CODE)PATCH_MMI_MESSAGE_HOOK=10134310-10134317

// PageActionHook
-Z(CODE)PATCH_PageActionImpl_All=140268F0-140268F7
-Z(CODE)PATCH_PageActionImpl_EnterExit=14026B5C-14026B63

//elfpackdata
-Z(CODE)EPD=4BB05150-4BB05153
