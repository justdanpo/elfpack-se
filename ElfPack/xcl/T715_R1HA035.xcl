-carm
//T715_R1HA035
-Z(CODE)START,CODE,DATA_C,INITTAB=15D94000-15DB6FFF

-Z(CODE)PATCH_SWI=101CC84C-101CC853
-Z(CODE)LIB=15D90000-15D93FFF


// change keyhandler
-Z(CODE)PATCH_KEYHANDLER1=1410589C-141058A3
-Z(CODE)PATCH_KEYHANDLER2=14105F88-14105F8F
-Z(CODE)PATCH_KEYHANDLER3=14105C64-14105C6B
-Z(CODE)PATCH_KEYHANDLER3_NOP=14105C92
-Z(CODE)PATCH_KEYHANDLER3_CHANGE1=14105D18
-Z(CODE)PATCH_KEYHANDLER3_CHANGE2=14105D52

// elf file association
-Z(CODE)PATCH_DB1=142D9428-142D942F
-Z(CODE)PATCH_DB2=142D9820-142D9827
-Z(CODE)PATCH_DB3=14F02D88-14F02D8F
-Z(CODE)PATCH_DB4=14F2BB30-14F2BB37

// lists initialization
// initialization of KbdHookList, Helper, Daemons
-Z(CODE)PATCH_AUTO_RUN=15B1A758-15B1A75B
-Z(CODE)PATCH_AUTO_RUN1=15B1A75C-15B1A75F

//OseHook
-Z(CODE)PATCH_MMI_MESSAGE_HOOK=10129D04-10129D0B

// PageActionHook
-Z(CODE)PATCH_PageActionImpl_All=14102F78-14102F7F
-Z(CODE)PATCH_PageActionImpl_EnterExit=14045420-14045427

//elfpackdata
-Z(CODE)EPD=4BB04094-4BB04097
