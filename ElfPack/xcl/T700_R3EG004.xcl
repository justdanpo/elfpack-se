-carm
//T700_R3EG004
-Z(CODE)START,CODE,DATA_C,INITTAB=12644000-1264FFFF

-Z(CODE)PATCH_SWI=0x1017AEF8-1017AEFF
-Z(CODE)LIB=12640000-12643FFF

// инициализация списков
-Z(CODE)PATCH_STANDBY_CALL=10D64F90-10D64F97

// change keyhandler
-Z(CODE)PATCH_KEYHANDLER1=1099F9A0-1099F9A7
-Z(CODE)PATCH_KEYHANDLER2=1099FDF0-1099FDF7
-Z(CODE)PATCH_KEYHANDLER3=1099FF48-1099FF4F
-Z(CODE)PATCH_KEYHANDLER4=1099FA48-1099FA4F

// ассоциация elf
-Z(CODE)PATCH_DB1=117B87EC-117B87F3
-Z(CODE)PATCH_DB2=117B85F4-117B85FB
-Z(CODE)PATCH_DB3=117B849C-117B84A3
-Z(CODE)PATCH_DB4=117B8E68-117B8E6F
-Z(CODE)PATCH_DB5=117B8640-117B8647
-Z(CODE)PATCH_DB6=117B8674-117B867B

// инициализация KbdHookList, Helper, Daemons
-Z(CODE)PATCH_AUTO_RUN=11EBA578-11EBA57B
-Z(CODE)PATCH_AUTO_RUN1=11EBA57C-11EBA57F

//OseHook
-Z(CODE)PATCH_MMI_MESSAGE_HOOK=111E8344-111E834B

// PageActionHook
-Z(CODE)PATCH_PageActionImpl_All=10DC7438-10DC743F
-Z(CODE)PATCH_PageActionImpl_EnterExit=10DC7B08-10DC7B0F

//elfpackdata
-Z(CODE)EPD=4BB99134-4BB99137
