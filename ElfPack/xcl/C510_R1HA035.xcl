-carm
//C510_R1HA035
-Z(CODE)START,CODE,DATA_C,INITTAB=15D94000-15DB6FFF

-Z(CODE)PATCH_SWI=101CC930-101CC937
-Z(CODE)LIB=15D90000-15D93FFF


// change keyhandler
-Z(CODE)PATCH_KEYHANDLER1=141C6440-141C6447
-Z(CODE)PATCH_KEYHANDLER2=141C6754-141C675B
-Z(CODE)PATCH_KEYHANDLER3=1449FE24-1449FE2B
-Z(CODE)PATCH_KEYHANDLER3_NOP=1449FE52
-Z(CODE)PATCH_KEYHANDLER3_CHANGE1=1449FED8
-Z(CODE)PATCH_KEYHANDLER3_CHANGE2=1449FF12

// elf file association
-Z(CODE)PATCH_DB1=142C7F14-142C7F1B
-Z(CODE)PATCH_DB2=142C85D4-142C85DB
-Z(CODE)PATCH_DB3=14F10B34-14F10B3B
-Z(CODE)PATCH_DB4=14F37808-14F3780F

// lists initialization
// initialization of KbdHookList, Helper, Daemons
-Z(CODE)PATCH_AUTO_RUN=15BEFC70-15BEFC73
-Z(CODE)PATCH_AUTO_RUN1=15BEFC74-15BEFC7B

//OseHook
-Z(CODE)PATCH_MMI_MESSAGE_HOOK=10129BB4-10129BBB

// PageActionHook
-Z(CODE)PATCH_PageActionImpl_All=1430DEB0-1430DEB7
-Z(CODE)PATCH_PageActionImpl_EnterExit=14481A38-14481A3F

//elfpackdata
-Z(CODE)EPD=4BAFFB30-4BAFFB33