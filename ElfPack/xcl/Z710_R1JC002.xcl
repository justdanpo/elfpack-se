//Z710_R1JC002
-carm
-Z(CODE)START,CODE,DATA_C,INITTAB=45C30000-45C3FFFF

-Z(CODE)PATCH_SWI=44309F20-44309F27
-Z(CODE)LIB=45C40000-45C44000

// change keyhandler
-Z(CODE)PATCH_KEYHANDLER1=452FE9C8-452FE9CF
-Z(CODE)PATCH_KEYHANDLER2=452FEE0C-452FEE13
-Z(CODE)PATCH_KEYHANDLER3=452FEF1C-452FEF23
-Z(CODE)PATCH_KEYHANDLER1_STACK1=452FE8CE
-Z(CODE)PATCH_KEYHANDLER1_STACK2=452FEAB2
-Z(CODE)PATCH_KEYHANDLER1_CHANGE1=452FEA0E
-Z(CODE)PATCH_KEYHANDLER1_CHANGE2=452FEA4A
-Z(CODE)PATCH_KEYHANDLER1_CHANGE3=452FEA7C
-Z(CODE)PATCH_KEYHANDLER1_CHANGE4=452FEAAC

// elf file association
-Z(CODE)PATCH_DB1=44E7057C-44E70583
-Z(CODE)PATCH_DB2=44E70364-44E7036B
-Z(CODE)PATCH_DB3=44E701E4-44E701EB
-Z(CODE)PATCH_DB4=44E70BD4-44E70BDB

// lists initialization
// initialization of KbdHookList, Helper, Daemons
-Z(CODE)PATCH_AUTO_RUN=459E46B0-459E46B3
-Z(CODE)PATCH_AUTO_RUN1=459E46B4-459E46B7

//OseHook
-Z(CODE)PATCH_MMI_MESSAGE_HOOK=44799D3C-44799D43

// PageActionHook
-Z(CODE)PATCH_PageActionImpl_All=45249794-4524979B
-Z(CODE)PATCH_PageActionImpl_EnterExit=4524A1C0-4524A1C7

// TabMenuBar check
-Z(CODE)PATCH_TabMenuCheck=4530D288-4530D28F

//elfpackdata
-Z(CODE)EPD=200547DC-200547DF
