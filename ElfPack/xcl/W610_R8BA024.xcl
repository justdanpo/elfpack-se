-carm
//W610_R8BA024
-Z(CODE)START,CODE,DATA_C,INITTAB=45C30000-45C3FFFF

-Z(CODE)PATCH_SWI=4430D1E8-4430D1F0
-Z(CODE)LIB=45C40000-45C44000

// инициализация списков
-Z(CODE)PATCH_STANDBY_CALL=452BE048-452BE04F

// change keyhandler
-Z(CODE)PATCH_KEYHANDLER1=4535320C-45353213
-Z(CODE)PATCH_KEYHANDLER2=45353668-4535366F
-Z(CODE)PATCH_KEYHANDLER3=45353780-45353787
-Z(CODE)PATCH_KEYHANDLER4=453532B4-453532BB

// ассоциация elf
-Z(CODE)PATCH_DB1=44EBC110-44EBC117
-Z(CODE)PATCH_DB2=44EBBEFC-44EBBF03
-Z(CODE)PATCH_DB3=44EBBD78-44EBBD81
-Z(CODE)PATCH_DB4=44EBC764-44EBC76B

// инициализация KbdHookList, Helper, Daemons
-Z(CODE)PATCH_AUTO_RUN=45A50758-45A5075B
-Z(CODE)PATCH_AUTO_RUN1=45A5075C-45A5075F

//OseHook
-Z(CODE)PATCH_MMI_MESSAGE_HOOK=447C7E20-447C7E27

// PageActionHook
-Z(CODE)PATCH_PageActionImpl_All=452AA2F0-452AA2F7
-Z(CODE)PATCH_PageActionImpl_EnterExit=452AAD2C-452AAD33

// TabMenuBar check
-Z(CODE)PATCH_TabMenuCheck=45361B18-45361B1F

//elfpackdata
-Z(CODE)EPD=2005B5B4-2005B5B7
