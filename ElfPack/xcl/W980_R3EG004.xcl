 -carm
//W980_R3EG004
-Z(CODE)START,CODE,DATA_C,INITTAB=12804000-1280FFFF

-Z(CODE)PATCH_SWI=10171B88-10171B8F
-Z(CODE)LIB=12800000-12803FFF

// change keyhandler
-Z(CODE)PATCH_KEYHANDLER1=109C4C50-109C4C57
-Z(CODE)PATCH_KEYHANDLER2=109C4CA0-109C4CA7
-Z(CODE)PATCH_KEYHANDLER3=109C51F8-109C51FF
-Z(CODE)PATCH_KEYHANDLER1_STACK1=109C4B06
-Z(CODE)PATCH_KEYHANDLER1_STACK2=109C4D4A
-Z(CODE)PATCH_KEYHANDLER1_CHANGE1=109C4C96
-Z(CODE)PATCH_KEYHANDLER1_CHANGE2=109C4CD4
-Z(CODE)PATCH_KEYHANDLER1_CHANGE3=109C4D06
-Z(CODE)PATCH_KEYHANDLER1_CHANGE4=109C4D40

// elf file association
-Z(CODE)PATCH_DB1=117EB8B4-117EB8BB
-Z(CODE)PATCH_DB2=117EB6BC-117EB6C3
-Z(CODE)PATCH_DB3=117EB564-117EB56B
-Z(CODE)PATCH_DB4=117EBF30-117EBF47
-Z(CODE)PATCH_DB5=117EB708-117EB70F
-Z(CODE)PATCH_DB6=117EB73C-117EB743

// lists initialization
// initialization of KbdHookList, Helper, Daemons
-Z(CODE)PATCH_AUTO_RUN=11EF3014-11EF3017
-Z(CODE)PATCH_AUTO_RUN1=11EF3018-11EF301B

//OseHook
-Z(CODE)PATCH_MMI_MESSAGE_HOOK=11214F3C-11214F43

// PageActionHook
-Z(CODE)PATCH_PageActionImpl_All=10DEEFC4-10DEEFCB
-Z(CODE)PATCH_PageActionImpl_EnterExit=10DEF68C-10DEF693

//elfpackdata
-Z(CODE)EPD=4BB94450-4BB94453
