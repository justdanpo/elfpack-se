-carm
//K850_R1FA035
-Z(CODE)START,CODE,DATA_C,INITTAB=12214000-12224000

-Z(CODE)PATCH_SWI=100EAA6C-100EAA74

-Z(CODE)LIB=12210000-12213FFF

// инициализация списков
-Z(CODE)PATCH_STANDBY_CALL=115C5B14-115C5B1B

//OseHook
-Z(CODE)PATCH_MMI_MESSAGE_HOOK=1070CE68-1070CE6F

// change keyhandler
-Z(CODE)PATCH_KEYHANDLER1=1164F090-1164F097
-Z(CODE)PATCH_KEYHANDLER2=1164F4D4-1164F4DB
-Z(CODE)PATCH_KEYHANDLER3=1164F60C-1164F613
-Z(CODE)PATCH_KEYHANDLER4=1164F140-1164F147

// инициализация KbdHookList, Helper, Daemons
-Z(CODE)PATCH_AUTO_RUN=11B3159C-11B3159F
-Z(CODE)PATCH_AUTO_RUN1=11B315A0-11B315A3

// ассоциация elf
-Z(CODE)PATCH_DB1=10FCE650-10FCE657
-Z(CODE)PATCH_DB2=10FCE69C-10FCE6A3
-Z(CODE)PATCH_DB3=10FCE6D0-10FCE6D7
-Z(CODE)PATCH_DB4=10FCE844-10FCE84B
-Z(CODE)PATCH_DB5=10FCE510-10FCE517
-Z(CODE)PATCH_DB6=10FCF020-10FCF027

// PageActionHook
-Z(CODE)PATCH_PageActionImpl_All=115B9854-115B985B
-Z(CODE)PATCH_PageActionImpl_EnterExit=115B9EEC-115B9EF3

//elfpackdata
-Z(CODE)EPD=29C55B10-29C55B13
