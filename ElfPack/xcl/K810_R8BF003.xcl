-carm
//K810_R8BF003
-Z(CODE)START,CODE,DATA_C,INITTAB=45D40000-45D4FFFF

-Z(CODE)PATCH_SWI=44433F28-44433F2F
-Z(CODE)LIB=45D50000-45D55000

// инициализация списков
-Z(CODE)PATCH_STANDBY_CALL=453CDE00-453CDE07

// change keyhandler
-Z(CODE)PATCH_KEYHANDLER1=454629C0-454629C7
-Z(CODE)PATCH_KEYHANDLER2=45462E1C-45462E23
-Z(CODE)PATCH_KEYHANDLER3=45462F34-45462F3B
-Z(CODE)PATCH_KEYHANDLER4=45462A68-45462A6F

// ассоциация elf
-Z(CODE)PATCH_DB1=44FC6844-44FC684B
-Z(CODE)PATCH_DB2=44FC6630-44FC6637
-Z(CODE)PATCH_DB3=44FC64AC-44FC64B3
-Z(CODE)PATCH_DB4=44FC6E98-44FC6E9F

// инициализация KbdHookList, Helper, Daemons
-Z(CODE)PATCH_AUTO_RUN=45C66EAC-45C66EAF
-Z(CODE)PATCH_AUTO_RUN1=45C66EB0-45C66EB3

//OseHook
-Z(CODE)PATCH_MMI_MESSAGE_HOOK=448EF90C-448EF913

// PageActionHook
-Z(CODE)PATCH_PageActionImpl_All=453B9F54-453B9F5B
-Z(CODE)PATCH_PageActionImpl_EnterExit=453BA990-453BA997

// TabMenuBar check
-Z(CODE)PATCH_TabMenuCheck=45471254-4547125B

//elfpackdata
-Z(CODE)EPD=2005AF80-2005AF83
