-carm
//Z610_R6DA001
-Z(CODE)START,CODE,DATA_C,INITTAB=45B80E00-45B87FFF

-Z(CODE)PATCH_SWI=4442947C-44429483
-Z(CODE)LIB=45B88000-45B8FFFF

// инициализация списков
-Z(CODE)PATCH_STANDBY_CALL=45393204-4539320B

// change keyhandler
-Z(CODE)PATCH_KEYHANDLER1=454284F0-454284F7
-Z(CODE)PATCH_KEYHANDLER2=4542894C-45428953
-Z(CODE)PATCH_KEYHANDLER3=45428A64-45428A6B
-Z(CODE)PATCH_KEYHANDLER4=45428598-4542859F

// ассоциация elf
-Z(CODE)PATCH_DB1=44FA35A4-44FA35AB
-Z(CODE)PATCH_DB2=44FA3390-44FA3397
-Z(CODE)PATCH_DB3=44FA320C-44FA3213
-Z(CODE)PATCH_DB4=44FA3BF8-44FA3BFF

// инициализация KbdHookList, Helper, Daemons
-Z(CODE)PATCH_AUTO_RUN=45B3223C-45B3223F
-Z(CODE)PATCH_AUTO_RUN1=45B32240-45B32243

//OseHook
-Z(CODE)PATCH_MMI_MESSAGE_HOOK=448C2DC8-448C2DCF

// PageActionHook
-Z(CODE)PATCH_PageActionImpl_All=4537EDA4-4537EDAB
-Z(CODE)PATCH_PageActionImpl_EnterExit=4537F7E0-4537F7E7

// TabMenuBar check
-Z(CODE)PATCH_TabMenuCheck=45436DCC-45436DD3

//elfpackdata
-Z(CODE)EPD=2005956C-2005956F
