-carm
//W710_R1JC002
-Z(CODE)START,CODE,DATA_C,INITTAB=45C30000-45C3FFFF

-Z(CODE)PATCH_SWI=4430A5BC-4430A5C4
-Z(CODE)LIB=45C40000-45C44000

// change keyhandler
-Z(CODE)PATCH_KEYHANDLER1=4533EE68-4533EE6F
-Z(CODE)PATCH_KEYHANDLER2=4533F2AC-4533F2B3
-Z(CODE)PATCH_KEYHANDLER3=4533F3BC-4533F3C3
-Z(CODE)PATCH_KEYHANDLER1_STACK1=4533ED6E
-Z(CODE)PATCH_KEYHANDLER1_STACK2=4533EF52
-Z(CODE)PATCH_KEYHANDLER1_CHANGE1=4533EEAE
-Z(CODE)PATCH_KEYHANDLER1_CHANGE2=4533EEEA
-Z(CODE)PATCH_KEYHANDLER1_CHANGE3=4533EF1C
-Z(CODE)PATCH_KEYHANDLER1_CHANGE4=4533EF4C

// elf file association
-Z(CODE)PATCH_DB1=44E9B524-44E9B52B
-Z(CODE)PATCH_DB2=44E9B30C-44E9B315
-Z(CODE)PATCH_DB3=44E9B18C-44E9B195
-Z(CODE)PATCH_DB4=44E9BB7C-44E9BB85

// lists initialization
// initialization of KbdHookList, Helper, Daemons
-Z(CODE)PATCH_AUTO_RUN=45A55284-45A55287
-Z(CODE)PATCH_AUTO_RUN1=45A55288-45A5528B

//OseHook
-Z(CODE)PATCH_MMI_MESSAGE_HOOK=4479A3F8-4479A3FF

// PageActionHook
-Z(CODE)PATCH_PageActionImpl_All=45289504-4528950B
-Z(CODE)PATCH_PageActionImpl_EnterExit=45289F30-45289F37

// TabMenuBar check
-Z(CODE)PATCH_TabMenuCheck=4534D7D0-4534D7D7

//elfpackdata
-Z(CODE)EPD=20054E78-20054E7B
