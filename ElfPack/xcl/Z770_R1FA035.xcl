//Z770_R1FA035
-carm
-Z(CODE)START,CODE,DATA_C,INITTAB=1222D000-12237FFF

-Z(CODE)PATCH_SWI=100F2C04-100F2C0B
-Z(CODE)LIB=12229000-1222CFFF

// change keyhandler
-Z(CODE)PATCH_KEYHANDLER1=116ABB7C-116ABB83
-Z(CODE)PATCH_KEYHANDLER2=116ABFC0-116ABFC7
-Z(CODE)PATCH_KEYHANDLER3=116AC0F8-116AC0FF
-Z(CODE)PATCH_KEYHANDLER1_STACK1=116ABA6E
-Z(CODE)PATCH_KEYHANDLER1_STACK2=116ABC7C
-Z(CODE)PATCH_KEYHANDLER1_CHANGE1=116ABBC6
-Z(CODE)PATCH_KEYHANDLER1_CHANGE2=116ABC06
-Z(CODE)PATCH_KEYHANDLER1_CHANGE3=116ABC38
-Z(CODE)PATCH_KEYHANDLER1_CHANGE4=116ABC72

// elf file association
-Z(CODE)PATCH_DB1=110308C8-110308CF
-Z(CODE)PATCH_DB2=11030914-1103091B
-Z(CODE)PATCH_DB3=11030948-1103094F
-Z(CODE)PATCH_DB4=11030ABC-11030AC3
-Z(CODE)PATCH_DB5=11030788-1103078F
-Z(CODE)PATCH_DB6=11031298-1103129F

// lists initialization
// initialization of KbdHookList, Helper, Daemons
-Z(CODE)PATCH_AUTO_RUN=11B754B4-11B754B7
-Z(CODE)PATCH_AUTO_RUN1=11B754B8-11B754BB

//OseHook
-Z(CODE)PATCH_MMI_MESSAGE_HOOK=107613A4-107613AB

// PageActionHook
-Z(CODE)PATCH_PageActionImpl_All=116155AC-116155B3
-Z(CODE)PATCH_PageActionImpl_EnterExit=11615C44-11615C4B

//elfpackdata
-Z(CODE)EPD=2A2578E0-2A2578E3
