-carm
//K770_R8BA024
-Z(CODE)START,CODE,DATA_C,INITTAB=45D30000-45D3FFFF

-Z(CODE)PATCH_SWI=44433B84-44433B8C
-Z(CODE)LIB=45D40000-45D44000

// change keyhandler
-Z(CODE)PATCH_KEYHANDLER1=4548A814-4548A81B
-Z(CODE)PATCH_KEYHANDLER2=4548AC70-4548AC77
-Z(CODE)PATCH_KEYHANDLER3=4548AD88-4548AD8F
-Z(CODE)PATCH_KEYHANDLER1_STACK1=4548A71E
-Z(CODE)PATCH_KEYHANDLER1_STACK2=4548A8FE
-Z(CODE)PATCH_KEYHANDLER1_CHANGE1=4548A85A
-Z(CODE)PATCH_KEYHANDLER1_CHANGE2=4548A896
-Z(CODE)PATCH_KEYHANDLER1_CHANGE3=4548A8C8
-Z(CODE)PATCH_KEYHANDLER1_CHANGE4=4548A8F8

// elf file association
-Z(CODE)PATCH_DB1=44FECDDC-44FECDE3
-Z(CODE)PATCH_DB2=44FECBC8-44FECBCF
-Z(CODE)PATCH_DB3=44FECA44-44FECA4B
-Z(CODE)PATCH_DB4=44FED430-44FED437

// lists initialization
// initialization of KbdHookList, Helper, Daemons
-Z(CODE)PATCH_AUTO_RUN=45CC8920-45CC8923
-Z(CODE)PATCH_AUTO_RUN1=45CC8924-45CC8927

//OseHook
-Z(CODE)PATCH_MMI_MESSAGE_HOOK=448FA87C-448FA883

// PageActionHook
-Z(CODE)PATCH_PageActionImpl_All=453E1CE0-453E1CE7
-Z(CODE)PATCH_PageActionImpl_EnterExit=453E271C-453E2723

// TabMenuBar check
-Z(CODE)PATCH_TabMenuCheck=45499190-45499197

//elfpackdata
-Z(CODE)EPD=2005A458-2005A45B
