-carm
//T707_R1FA035
-Z(CODE)START,CODE,DATA_C,INITTAB=15CAD000-15CCFFFF

-Z(CODE)PATCH_SWI=101E8904-101E890B
-Z(CODE)LIB=15CA9000-15CACFFF

// change keyhandler
-Z(CODE)PATCH_KEYHANDLER1=142E9B54-142E9B5B
-Z(CODE)PATCH_KEYHANDLER2=1446174C-14461753
-Z(CODE)PATCH_KEYHANDLER3=142E970C-142E9713
-Z(CODE)PATCH_KEYHANDLER3_NOP=142E973A
-Z(CODE)PATCH_KEYHANDLER3_CHANGE1=142E97C0
-Z(CODE)PATCH_KEYHANDLER3_CHANGE2=142E97FA

// elf file association
-Z(CODE)PATCH_DB1=144DA338-144DA33F
-Z(CODE)PATCH_DB2=144D9F44-144D9F4B
-Z(CODE)PATCH_DB3=14EF0134-14EF013B
-Z(CODE)PATCH_DB4=14422780-14422787

// lists initialization
// initialization of KbdHookList, Helper, Daemons
-Z(CODE)PATCH_AUTO_RUN=15AEE780-15AEE783
-Z(CODE)PATCH_AUTO_RUN1=15AEE784-15AEE787

//OseHook
-Z(CODE)PATCH_MMI_MESSAGE_HOOK=101351B4-101351BB

// PageActionHook
-Z(CODE)PATCH_PageActionImpl_All=14026568-1402656F
-Z(CODE)PATCH_PageActionImpl_EnterExit=140267D4-140267DB

//elfpackdata
-Z(CODE)EPD=4BB00AAC-4BB00AAF
