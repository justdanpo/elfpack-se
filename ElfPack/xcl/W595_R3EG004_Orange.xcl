-carm
//W595_R3EG004_Orange
-Z(CODE)START,CODE,DATA_C,INITTAB=126B4000-126BFFFF

-Z(CODE)PATCH_SWI=1017AEF4-1017AEFB
-Z(CODE)LIB=126B0000-126B3FFF

-Z(CODE)PATCH_STANDBY_CALL=10DFA1F4-10DFA1FC

// change keyhandler
-Z(CODE)PATCH_KEYHANDLER1=10A338A8-10A338AF
-Z(CODE)PATCH_KEYHANDLER2=10A33CF8-10A33CFF
-Z(CODE)PATCH_KEYHANDLER3=10A33E50-10A33E57
-Z(CODE)PATCH_KEYHANDLER4=10A33950-10A33957

// ассоциация elf
-Z(CODE)PATCH_DB1=1185FA20-1185FA27
-Z(CODE)PATCH_DB2=1185F828-1185F82F
-Z(CODE)PATCH_DB3=1185F6D0-1185F6D7
-Z(CODE)PATCH_DB4=1186009C-118600A3
-Z(CODE)PATCH_DB5=1185F874-1185F87B
-Z(CODE)PATCH_DB6=1185F8A8-119071F7

// инициализация KbdHookList, Helper, Daemons
-Z(CODE)PATCH_AUTO_RUN=11F69268-11F6926B
-Z(CODE)PATCH_AUTO_RUN1=11F6926C-11F6926F

//OseHook
-Z(CODE)PATCH_MMI_MESSAGE_HOOK=1127B5C8-1127B5CF

// PageActionHook
-Z(CODE)PATCH_PageActionImpl_All=10E5CA90-10E5CA97
-Z(CODE)PATCH_PageActionImpl_EnterExit=10E5D160-10E5D167

//elfpackdata
-Z(CODE)EPD=4BB9958C-4BB9958F
