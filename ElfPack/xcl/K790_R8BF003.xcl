/*
        Thanks to GPcH for sponsoring this hard work
*/

-carm
//K790_R8BF003
-Z(CODE)START,CODE,DATA_C,INITTAB=45B10000-45B1FFFF

-Z(CODE)PATCH_SWI=4430CE4C-4430CE53
-Z(CODE)LIB=45B20000-45B25000

// инициализация списков
-Z(CODE)PATCH_STANDBY_CALL=4527DB34-4527DB3B

// change keyhandler
-Z(CODE)PATCH_KEYHANDLER1=45312668-4531266F
-Z(CODE)PATCH_KEYHANDLER2=45312AC4-45312ACB
-Z(CODE)PATCH_KEYHANDLER3=45312BDC-45312BE3
-Z(CODE)PATCH_KEYHANDLER4=45312710-45312717

// ассоциация elf
-Z(CODE)PATCH_DB1=44E8A5B8-44E8A5BF
-Z(CODE)PATCH_DB2=44E8A3A4-44E8A3AB
-Z(CODE)PATCH_DB3=44E8A220-44E8A227
-Z(CODE)PATCH_DB4=44E8AC0C-44E8AC13

// инициализация KbdHookList, Helper, Daemons
-Z(CODE)PATCH_AUTO_RUN=45AB90F4-45AB90F7
-Z(CODE)PATCH_AUTO_RUN1=45AB90F8-45AB90FB

//OseHook
-Z(CODE)PATCH_MMI_MESSAGE_HOOK=447B2D14-447B2D1B

// PageActionHook
-Z(CODE)PATCH_PageActionImpl_All=45269DEC-45269DF3
-Z(CODE)PATCH_PageActionImpl_EnterExit=4526A828-4526A82F

// TabMenuBar check
-Z(CODE)PATCH_TabMenuCheck=45320E5C-45320E63

//elfpackdata
-Z(CODE)EPD=2005ADEC-2005ADEF
