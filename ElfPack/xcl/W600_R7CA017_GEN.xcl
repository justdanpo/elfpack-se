-carm
//W600_R7CA017_GEN
-Z(CODE)START,CODE,DATA_C,INITTAB=45618000-4561FFFF

-Z(CODE)PATCH_SWI=440EFFDC-440EFFE3
-Z(CODE)LIB=45620000-45624000

// change keyhandler
-Z(CODE)PATCH_KEYHANDLER1=45241FB0-45241FB7
-Z(CODE)PATCH_KEYHANDLER2=4524262C-45242633
-Z(CODE)PATCH_KEYHANDLER3=452427B0-452427B7
-Z(CODE)PATCH_KEYHANDLER1_STACK1=45241ED8
-Z(CODE)PATCH_KEYHANDLER1_STACK2=45242084
-Z(CODE)PATCH_KEYHANDLER1_CHANGE1=45241FFC
-Z(CODE)PATCH_KEYHANDLER1_CHANGE2=45242038
-Z(CODE)PATCH_KEYHANDLER1_CHANGE3=45242048
-Z(CODE)PATCH_KEYHANDLER1_CHANGE4=4524207E

// elf file association
-Z(CODE)PATCH_DB2=45501830-45501833
-Z(CODE)PATCH_DB1=4550193E-45501941

// lists initialization
// initialization of KbdHookList, Helper, Daemons
-Z(CODE)PATCH_AUTO_RUN=444C3638-444C363B
-Z(CODE)PATCH_AUTO_RUN1=444C363C-444C363F

//OseHook
-Z(CODE)PATCH_MMI_MESSAGE_HOOK=44B39E00-44B39E09

// PageActionHook
-Z(CODE)PATCH_PageActionImpl_All=4546BA90-4546BA97
-Z(CODE)PATCH_PageActionImpl_EnterExit=451DE868-451DE86F

// TabMenuBar check
-Z(CODE)PATCH_TabMenuCheck=4508DFE4-4508DFEB

//elfpackdata
-Z(CODE)EPD=4C0B7624-4C0B7627
