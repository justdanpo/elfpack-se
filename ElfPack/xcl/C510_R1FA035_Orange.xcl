-carm
//C510_R1FA035_Orange
-Z(CODE)START,CODE,DATA_C,INITTAB=15DF4000-15DFBFFF

-Z(CODE)PATCH_SWI=101CCC60-101CCC67
-Z(CODE)LIB=15DF0000-15DFC3FF

// инициализация списков
-Z(CODE)PATCH_STANDBY_CALL=14FDFC14-14FDFC1B

// change keyhandler
-Z(CODE)PATCH_KEYHANDLER1=141C3D70-141C3D77
-Z(CODE)PATCH_KEYHANDLER2=141C4084-141C408B
-Z(CODE)PATCH_KEYHANDLER3=1449A2C0-1449A2C7
-Z(CODE)PATCH_KEYHANDLER4=1449A364-1449A36B

// ассоциация elf
-Z(CODE)PATCH_DB1=142C43E0-142C43E7
-Z(CODE)PATCH_DB2=142C4AA0-142C4AA7
-Z(CODE)PATCH_DB3=14F7D358-14F7D35F
-Z(CODE)PATCH_DB4=14FA425C-14FA4263


// инициализация KbdHookList, Helper, Daemons
-Z(CODE)PATCH_AUTO_RUN=15C5D2E8-15C5D2EB
-Z(CODE)PATCH_AUTO_RUN1=15C5D2EC-15C5D2EF

//OseHook
-Z(CODE)PATCH_MMI_MESSAGE_HOOK=10129A00-10129A07

// PageActionHook
-Z(CODE)PATCH_PageActionImpl_All=14309F5C-14309F63
-Z(CODE)PATCH_PageActionImpl_EnterExit=1447C014-1447C01B

//elfpackdata
-Z(CODE)EPD=4BAFF47C-4BAFF47F
