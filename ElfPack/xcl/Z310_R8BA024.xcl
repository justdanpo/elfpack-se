-carm
//Z310_R8BA024
-Z(CODE)START,CODE,DATA_C,INITTAB=219F0000-219FFFFF

-Z(CODE)PATCH_SWI=2018198C-20181993
-Z(CODE)LIB=219EC000-219EFFFF

// change keyhandler
-Z(CODE)PATCH_KEYHANDLER1=20F47EB8-20F47EBF
-Z(CODE)PATCH_KEYHANDLER2=20F48314-20F4831B
-Z(CODE)PATCH_KEYHANDLER3=20F4842C-20F48433
-Z(CODE)PATCH_KEYHANDLER1_STACK1=20F47DC2
-Z(CODE)PATCH_KEYHANDLER1_STACK2=20F47FA2
-Z(CODE)PATCH_KEYHANDLER1_CHANGE1=20F47EFE
-Z(CODE)PATCH_KEYHANDLER1_CHANGE2=20F47F3A
-Z(CODE)PATCH_KEYHANDLER1_CHANGE3=20F47F6C
-Z(CODE)PATCH_KEYHANDLER1_CHANGE4=20F47F8C

// elf file association
-Z(CODE)PATCH_DB1=20B4A8C8-20B4A8CF
-Z(CODE)PATCH_DB2=20B4A704-20B4A70B
-Z(CODE)PATCH_DB3=20B4A5C0-20B4A5C7
-Z(CODE)PATCH_DB4=20B4AD6C-20B4AD73

// lists initialization
// initialization of KbdHookList, Helper, Daemons
-Z(CODE)PATCH_AUTO_RUN=21494130-21494133
-Z(CODE)PATCH_AUTO_RUN1=21494134-21494137

//OseHook
-Z(CODE)PATCH_MMI_MESSAGE_HOOK=2050CD4C-2050CD53

// PageActionHook
-Z(CODE)PATCH_PageActionImpl_All=20EA69BC-20EA69C3
-Z(CODE)PATCH_PageActionImpl_EnterExit=20EA7334-20EA733B

// TabMenuBar check
-Z(CODE)PATCH_TabMenuCheck=20F55E10-20F55E17

//elfpackdata
-Z(CODE)EPD=4803E648-4803E64B
