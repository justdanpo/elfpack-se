//K630_R1FA032
-carm
-Z(CODE)START,CODE,DATA_C,INITTAB=12194000-121B6FFF

-Z(CODE)PATCH_SWI=100EBA50-100EBA57
-Z(CODE)LIB=12190000-12193FFF

// change keyhandler
-Z(CODE)PATCH_KEYHANDLER1=1162C420-1162C427
-Z(CODE)PATCH_KEYHANDLER2=1162C864-1162C86B
-Z(CODE)PATCH_KEYHANDLER3=1162C99C-1162C9A3
-Z(CODE)PATCH_KEYHANDLER1_STACK1=1162C312
-Z(CODE)PATCH_KEYHANDLER1_STACK2=1162C520
-Z(CODE)PATCH_KEYHANDLER1_CHANGE1=1162C46A
-Z(CODE)PATCH_KEYHANDLER1_CHANGE2=1162C4AA
-Z(CODE)PATCH_KEYHANDLER1_CHANGE3=1162C4DC
-Z(CODE)PATCH_KEYHANDLER1_CHANGE4=1162C516

// elf file association
-Z(CODE)PATCH_DB1=10FB562C-10FB5633
-Z(CODE)PATCH_DB2=10FB5678-10FB567F
-Z(CODE)PATCH_DB3=10FB56AC-10FB56B3
-Z(CODE)PATCH_DB4=10FB5820-10FB5827
-Z(CODE)PATCH_DB5=10FB54EC-10FB54F3
-Z(CODE)PATCH_DB6=10FB5FFC-10FB6003

// lists initialization
// initialization of KbdHookList, Helper, Daemons
-Z(CODE)PATCH_AUTO_RUN=11B00920-11B00923
-Z(CODE)PATCH_AUTO_RUN1=11B00924-11B00927

//OseHook
-Z(CODE)PATCH_MMI_MESSAGE_HOOK=106F67A8-106F67AF

// PageActionHook
-Z(CODE)PATCH_PageActionImpl_All=11596CC4-11596CCB
-Z(CODE)PATCH_PageActionImpl_EnterExit=1159735C-11597363

//elfpackdata
-Z(CODE)EPD=2A250734-2A250737
