-carm
//K550_R6BC002
-Z(CODE)START,CODE,DATA_C,INITTAB=45A40000-45A4FFFF

-Z(CODE)PATCH_SWI=4430BCD4-4430BCDB
-Z(CODE)LIB=45A50000-45A55000

// change keyhandler
-Z(CODE)PATCH_KEYHANDLER1=45315DF4-45315DFB
-Z(CODE)PATCH_KEYHANDLER2=45316250-45316257
-Z(CODE)PATCH_KEYHANDLER3=45316368-4531636F
-Z(CODE)PATCH_KEYHANDLER1_STACK1=45315CFE
-Z(CODE)PATCH_KEYHANDLER1_STACK2=45315EDE
-Z(CODE)PATCH_KEYHANDLER1_CHANGE1=45315E3A
-Z(CODE)PATCH_KEYHANDLER1_CHANGE2=45315E76
-Z(CODE)PATCH_KEYHANDLER1_CHANGE3=45315EA8
-Z(CODE)PATCH_KEYHANDLER1_CHANGE4=45315ED8

// elf file association
-Z(CODE)PATCH_DB1=44E8EC28-44E8EC2F
-Z(CODE)PATCH_DB2=44E8EA14-44E8EA1B
-Z(CODE)PATCH_DB3=44E8E890-44E8E897
-Z(CODE)PATCH_DB4=44E8F27C-44E8F283

// lists initialization
// initialization of KbdHookList, Helper, Daemons
-Z(CODE)PATCH_AUTO_RUN=459DC5E8-459DC5EB
-Z(CODE)PATCH_AUTO_RUN1=459DC5EC-459DC5EF

//OseHook
-Z(CODE)PATCH_MMI_MESSAGE_HOOK=447ABD48-447ABD4F

// PageActionHook
-Z(CODE)PATCH_PageActionImpl_All=4526D744-4526D74B
-Z(CODE)PATCH_PageActionImpl_EnterExit=4526E180-4526E187

// TabMenuBar check
-Z(CODE)PATCH_TabMenuCheck=453245E8-453245EF

//elfpackdata
-Z(CODE)EPD=2005AB14-2005AB17
