-carm
//K530_R8BB001
-Z(CODE)START,CODE,DATA_C,INITTAB=45C30000-45C3FFFF

-Z(CODE)PATCH_SWI=4442AB90-4442AB97
-Z(CODE)LIB=45C40000-45C44000

// change keyhandler
-Z(CODE)PATCH_KEYHANDLER1=45446030-45446037
-Z(CODE)PATCH_KEYHANDLER2=4544648C-45446493
-Z(CODE)PATCH_KEYHANDLER3=454465A4-454465AB
-Z(CODE)PATCH_KEYHANDLER1_STACK1=45445F3A
-Z(CODE)PATCH_KEYHANDLER1_STACK2=4544611A
-Z(CODE)PATCH_KEYHANDLER1_CHANGE1=45446076
-Z(CODE)PATCH_KEYHANDLER1_CHANGE2=454460B2
-Z(CODE)PATCH_KEYHANDLER1_CHANGE3=454460E4
-Z(CODE)PATCH_KEYHANDLER1_CHANGE4=45446114

// elf file association
-Z(CODE)PATCH_DB1=44FB1054-44FB105B
-Z(CODE)PATCH_DB2=44FB0E40-44FB0E47
-Z(CODE)PATCH_DB3=44FB0CBC-44FB0CC3
-Z(CODE)PATCH_DB4=44FB16A8-44FB16AF

// lists initialization
// initialization of KbdHookList, Helper, Daemons
-Z(CODE)PATCH_AUTO_RUN=45B66A4C-45B66A4F
-Z(CODE)PATCH_AUTO_RUN1=45B66A50-45B66A53

// OseHook
-Z(CODE)PATCH_MMI_MESSAGE_HOOK=448E7840-448E7847

// PageActionHook
-Z(CODE)PATCH_PageActionImpl_All=4539D8C4-4539D8CB
-Z(CODE)PATCH_PageActionImpl_EnterExit=4539E300-4539E307

// TabMenuBar check
-Z(CODE)PATCH_TabMenuCheck=45454854-4545485B

// elfpackdata
-Z(CODE)EPD=20059AE8-20059AEB
