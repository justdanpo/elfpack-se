-carm
//W580_R8BE001_Orange
-Z(CODE)START,CODE,DATA_C,INITTAB=45CF7000-45CFFFFF

-Z(CODE)PATCH_SWI=44307F24-44307F2C
-Z(CODE)LIB=45D00000-45D03FFF

// change keyhandler
-Z(CODE)PATCH_KEYHANDLER1=45392EDC-45392EE3
-Z(CODE)PATCH_KEYHANDLER2=45393338-4539333F
-Z(CODE)PATCH_KEYHANDLER3=45393450-45393457
-Z(CODE)PATCH_KEYHANDLER1_STACK1=45392DE6
-Z(CODE)PATCH_KEYHANDLER1_STACK2=45392FC6
-Z(CODE)PATCH_KEYHANDLER1_CHANGE1=45392F22
-Z(CODE)PATCH_KEYHANDLER1_CHANGE2=45392F5E
-Z(CODE)PATCH_KEYHANDLER1_CHANGE3=45392F90
-Z(CODE)PATCH_KEYHANDLER1_CHANGE4=45392FC0

// elf file association
-Z(CODE)PATCH_DB1=44EE5270-44EE5277
-Z(CODE)PATCH_DB2=44EE505C-44EE5063
-Z(CODE)PATCH_DB3=44EE4ED8-44EE4EE1
-Z(CODE)PATCH_DB4=44EE58C4-44EE58CB

// lists initialization
// initialization of KbdHookList, Helper, Daemons
-Z(CODE)PATCH_AUTO_RUN=45BCDB58-45BCDB5B
-Z(CODE)PATCH_AUTO_RUN1=45BCDB5C-45BCDB5F

//OseHook
-Z(CODE)PATCH_MMI_MESSAGE_HOOK=447D5F54-447D5F5B

// PageActionHook
-Z(CODE)PATCH_PageActionImpl_All=452E92AC-452E92B3
-Z(CODE)PATCH_PageActionImpl_EnterExit=452E9CE8-452E9CEF

// TabMenuBar check
-Z(CODE)PATCH_TabMenuCheck=453A1784-453A178B

//elfpackdata
-Z(CODE)EPD=2005A3E0-2005A3E3
