-carm
//W800_R1BD001
-Z(CODE)START,CODE,DATA_C,INITTAB=451F8000-451FFFFF

-Z(CODE)PATCH_SWI=440670B4-440670BB
-Z(CODE)LIB=45200000-45204000


// инициализация списков
-Z(CODE)PATCH_STANDBY_CALL=44EA7690-44EA7697

// change keyhandler
-Z(CODE)PATCH_KEYHANDLER1=44E8A98C-44E8A993
-Z(CODE)PATCH_KEYHANDLER2=44E8AF80-44E8AF87
-Z(CODE)PATCH_KEYHANDLER3=44E8B0F8-44E8B0FF

// ассоциация elf
-Z(CODE)PATCH_DB2=450EBA84-450EBA87
-Z(CODE)PATCH_DB1=450EBBAC-450EBBAF


// инициализация KbdHookList, Helper, Daemons
-Z(CODE)PATCH_AUTO_RUN=4429CE04-4429CE07
-Z(CODE)PATCH_AUTO_RUN1=4429CE08-4429CE0B

//OseHook
-Z(CODE)PATCH_MMI_MESSAGE_HOOK=448F38BC-448F38C5

// PageActionHook
-Z(CODE)PATCH_PageActionImpl_All=4505B3C0-4505B3C7
-Z(CODE)PATCH_PageActionImpl_EnterExit=44E82758-44E8275F

// TabMenuBar check
-Z(CODE)PATCH_TabMenuCheck=44D3B690-44D3B697

//elfpackdata
-Z(CODE)EPD=4C07A0B8-4C07A0BB
