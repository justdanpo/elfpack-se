-carm

//W910_R1FA037
-Z(CODE)START,CODE,DATA_C,INITTAB=1222D000-12237FFF

-Z(CODE)PATCH_SWI=100EBB04-100EBB0B
-Z(CODE)LIB=12229000-1222CFFF

// change keyhandler
-Z(CODE)PATCH_KEYHANDLER1=11667BCC-11667BD3
-Z(CODE)PATCH_KEYHANDLER2=11668010-11668017
-Z(CODE)PATCH_KEYHANDLER3=11668148-1166814F
-Z(CODE)PATCH_KEYHANDLER1_STACK1=11667ABE
-Z(CODE)PATCH_KEYHANDLER1_STACK2=11667CCC
-Z(CODE)PATCH_KEYHANDLER1_CHANGE1=11667C16
-Z(CODE)PATCH_KEYHANDLER1_CHANGE2=11667C56
-Z(CODE)PATCH_KEYHANDLER1_CHANGE3=11667C88
-Z(CODE)PATCH_KEYHANDLER1_CHANGE4=11667CC2

// elf file association
-Z(CODE)PATCH_DB1=10FE424C-10FE4253
-Z(CODE)PATCH_DB2=10FE4058-10FE405F
-Z(CODE)PATCH_DB3=10FE3F18-10FE3F1F
-Z(CODE)PATCH_DB4=10FE4A28-10FE4A2F
-Z(CODE)PATCH_DB5=10FE40A4-10FE40AB
-Z(CODE)PATCH_DB6=10FE40D8-10FE40DF

// lists initialization
// initialization of KbdHookList, Helper, Daemons
-Z(CODE)PATCH_AUTO_RUN=11B466A0-11B466A3
-Z(CODE)PATCH_AUTO_RUN1=11B466A4-11B466A7

//OseHook
-Z(CODE)PATCH_MMI_MESSAGE_HOOK=10721524-1072152B

// PageActionHook
-Z(CODE)PATCH_PageActionImpl_All=115D21F8-115D21FF
-Z(CODE)PATCH_PageActionImpl_EnterExit=115D2890-115D2897

//elfpackdata
-Z(CODE)EPD=2A2507E4-2A2507E7

