-carm
//W850_R1KG001
-Z(CODE)START,CODE,DATA_C,INITTAB=45CE7000-45CEFFFF

-Z(CODE)PATCH_SWI=44431D5C-44431D63
-Z(CODE)LIB=45CF0000-45CF3FFF

// инициализация списков
-Z(CODE)PATCH_STANDBY_CALL=453E2650-453E2657

// change keyhandler
-Z(CODE)PATCH_KEYHANDLER1=454778FC-45477903
-Z(CODE)PATCH_KEYHANDLER2=45477D30-45477D37
-Z(CODE)PATCH_KEYHANDLER3=45477E4C-45477E53
-Z(CODE)PATCH_KEYHANDLER4=454779A4-454779AB

// ассоциация elf
-Z(CODE)PATCH_DB1=44FD7998-44FD799F
-Z(CODE)PATCH_DB2=44FD7784-44FD778B
-Z(CODE)PATCH_DB3=44FD7600-44FD7609
-Z(CODE)PATCH_DB4=44FD7FF0-44FD7FF7

// инициализация KbdHookList, Helper, Daemons
-Z(CODE)PATCH_AUTO_RUN=45C97E58-45C97E5B
-Z(CODE)PATCH_AUTO_RUN1=45C97E5C-45C97E5F

//OseHook
-Z(CODE)PATCH_MMI_MESSAGE_HOOK=448DB538-448DB53F

// PageActionHook
-Z(CODE)PATCH_PageActionImpl_All=453CE8B4-453CE8BB
-Z(CODE)PATCH_PageActionImpl_EnterExit=453CF2E0-453CF2E7

// TabMenuBar check
-Z(CODE)PATCH_TabMenuCheck=45486178-4548617F

//elfpackdata
-Z(CODE)EPD=2005A3D4-2005A3D7
