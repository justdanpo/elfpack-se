-carm
//K600_R2BB001
-Z(CODE)START,CODE,DATA_C,INITTAB=21468000-2146FFFF

-Z(CODE)PATCH_SWI=200A2354-200A235B
-Z(CODE)LIB=21470000-21473FFF

// change keyhandler
-Z(CODE)PATCH_KEYHANDLER1=20264EB8-20264EBF
-Z(CODE)PATCH_KEYHANDLER2=202654AC-202654B3
-Z(CODE)PATCH_KEYHANDLER3=20265624-2026562B
-Z(CODE)PATCH_KEYHANDLER1_STACK1=20264DF8
-Z(CODE)PATCH_KEYHANDLER1_STACK2=20264F8A
-Z(CODE)PATCH_KEYHANDLER1_CHANGE1=20264F02
-Z(CODE)PATCH_KEYHANDLER1_CHANGE2=20264F3E
-Z(CODE)PATCH_KEYHANDLER1_CHANGE3=20264F4E
-Z(CODE)PATCH_KEYHANDLER1_CHANGE4=20264F84

// elf file association
-Z(CODE)PATCH_DB2=204E1FA8-204E1FAF
-Z(CODE)PATCH_DB1=204E20D4-204E20DB

// lists initialization
// initialization of KbdHookList, Helper, Daemons
-Z(CODE)PATCH_AUTO_RUN=20F8A9BC-20F8A9BF
-Z(CODE)PATCH_AUTO_RUN1=20F8A9C0-20F8A9C3

//OseHook
-Z(CODE)PATCH_MMI_MESSAGE_HOOK=209627C0-209627C9

// PageActionHook
-Z(CODE)PATCH_PageActionImpl_All=20425B94-20425B9B
-Z(CODE)PATCH_PageActionImpl_EnterExit=2025CC2C-2025CC33

// TabMenuBar check
-Z(CODE)PATCH_TabMenuCheck=207540D4-207540DB

//elfpackdata
-Z(CODE)EPD=28052928-2805292B
