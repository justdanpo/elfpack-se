-carm
//W902_R3EG004
-Z(CODE)START,CODE,DATA_C,INITTAB=12804000-1280FFFF

-Z(CODE)PATCH_SWI=1017AEF4-1017AEFB
-Z(CODE)LIB=12800000-12803FFF

// change keyhandler
-Z(CODE)PATCH_KEYHANDLER1=109CF0EC-109CF0F3
-Z(CODE)PATCH_KEYHANDLER2=109CF53C-109CF543
-Z(CODE)PATCH_KEYHANDLER3=109CF694-109CF69B
-Z(CODE)PATCH_KEYHANDLER1_STACK1=109CEFA2
-Z(CODE)PATCH_KEYHANDLER1_STACK2=109CF1E6
-Z(CODE)PATCH_KEYHANDLER1_CHANGE1=109CF132
-Z(CODE)PATCH_KEYHANDLER1_CHANGE2=109CF170
-Z(CODE)PATCH_KEYHANDLER1_CHANGE3=109CF1A2
-Z(CODE)PATCH_KEYHANDLER1_CHANGE4=109CF1DC

// elf file association
-Z(CODE)PATCH_DB1=117FE29C-117FE2A3
-Z(CODE)PATCH_DB2=117FE0A4-117FE0AB
-Z(CODE)PATCH_DB3=117FDF4C-117FDF53
-Z(CODE)PATCH_DB4=117FE918-117FE91F
-Z(CODE)PATCH_DB5=117FE0F0-117FE0F7
-Z(CODE)PATCH_DB6=117FE124-117FE12B

// lists initialization
// initialization of KbdHookList, Helper, Daemons
-Z(CODE)PATCH_AUTO_RUN=11FAD5D4-11FAD5D7
-Z(CODE)PATCH_AUTO_RUN1=11FAD5D8-11FAD5DB

//OseHook
-Z(CODE)PATCH_MMI_MESSAGE_HOOK=11225F18-11225F1F

// PageActionHook
-Z(CODE)PATCH_PageActionImpl_All=10DF7C88-10DF7C8F
-Z(CODE)PATCH_PageActionImpl_EnterExit=10DF8358-10DF835F

//elfpackdata
-Z(CODE)EPD=4BBA55EC-4BBA55EF
