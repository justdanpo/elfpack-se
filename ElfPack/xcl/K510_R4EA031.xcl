-carm
//K510_R4EA031
-Z(CODE)START,CODE,DATA_C,INITTAB=456B8000-456BFFFF

-Z(CODE)PATCH_SWI=4418439C-441843A3
-Z(CODE)LIB=456C0000-456C4000

// change keyhandler
-Z(CODE)PATCH_KEYHANDLER1=45217D94-45217D9B
-Z(CODE)PATCH_KEYHANDLER2=45218434-4521843B
-Z(CODE)PATCH_KEYHANDLER3=452185B8-452185BF
-Z(CODE)PATCH_KEYHANDLER1_STACK1=45217CB0
-Z(CODE)PATCH_KEYHANDLER1_STACK2=45217E68
-Z(CODE)PATCH_KEYHANDLER1_CHANGE1=45217DE0
-Z(CODE)PATCH_KEYHANDLER1_CHANGE2=45217E1C
-Z(CODE)PATCH_KEYHANDLER1_CHANGE3=45217E2C
-Z(CODE)PATCH_KEYHANDLER1_CHANGE4=45217E62

// elf file association
-Z(CODE)PATCH_DB2=454B5398-454B539B
-Z(CODE)PATCH_DB1=454B54A6-454B54AA

// lists initialization
// initialization of KbdHookList, Helper, Daemons
-Z(CODE)PATCH_AUTO_RUN=44553B78-44553B7B
-Z(CODE)PATCH_AUTO_RUN1=44553B7C-44553B7F

//OseHook
-Z(CODE)PATCH_MMI_MESSAGE_HOOK=44AFA668

// PageActionHook
-Z(CODE)PATCH_PageActionImpl_All=4543742C-45437433
-Z(CODE)PATCH_PageActionImpl_EnterExit=451AECFC-451AED03

// TabMenuBar check
-Z(CODE)PATCH_TabMenuCheck=45068B08-45068B0F

//elfpackdata
-Z(CODE)EPD=4C05E63C-4C05E63F
