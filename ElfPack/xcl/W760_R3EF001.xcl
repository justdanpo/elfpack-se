-carm
//W760_R3EF001
-Z(CODE)START,CODE,DATA_C,INITTAB=12784000-1278FFFF

-Z(CODE)PATCH_SWI=1017AEF4-1017AEFB
-Z(CODE)LIB=12780000-12783FFF

// инициализация списков
-Z(CODE)PATCH_STANDBY_CALL=10E28914-10E2891B

// change keyhandler
-Z(CODE)PATCH_KEYHANDLER1=10A61E9C-10A61EA3
-Z(CODE)PATCH_KEYHANDLER2=10A622EC-10A622F3
-Z(CODE)PATCH_KEYHANDLER3=10A62444-10A6244B
-Z(CODE)PATCH_KEYHANDLER4=10A61F44-10A61F4B

// ассоциация elf
-Z(CODE)PATCH_DB1=11883E2C-11883E33
-Z(CODE)PATCH_DB2=11883C34-11883C3B
-Z(CODE)PATCH_DB3=11883ADC-11883AE3
-Z(CODE)PATCH_DB4=118844A8-118844AF
-Z(CODE)PATCH_DB5=11883C80-11883C87
-Z(CODE)PATCH_DB6=11883CB4-11883CBB

// инициализация KbdHookList, Helper, Daemons
-Z(CODE)PATCH_AUTO_RUN=11F8A4C8-11F8A4CB
-Z(CODE)PATCH_AUTO_RUN1=11F8A4CC-11F8A4CF

//OseHook
-Z(CODE)PATCH_MMI_MESSAGE_HOOK=112AD4B8-112AD4BF

// PageActionHook
-Z(CODE)PATCH_PageActionImpl_All=10E8B1D0-10E8B1D7
-Z(CODE)PATCH_PageActionImpl_EnterExit=10E8B8A0-10E8B8A7

//elfpackdata
-Z(CODE)EPD=4BB99A1C-4BB99A1F
