-carm
//W508_R1FA035
-Z(CODE)START,CODE,DATA_C,INITTAB=15CAD000-15CCFFFF

-Z(CODE)PATCH_SWI=101E93C0-101E93C7
-Z(CODE)LIB=15CA9000-15CACFFF

// change keyhandler
-Z(CODE)PATCH_KEYHANDLER1=142EB054-142EB05B
-Z(CODE)PATCH_KEYHANDLER2=14464380-14464387
-Z(CODE)PATCH_KEYHANDLER3=142EAC0C-142EAC13
-Z(CODE)PATCH_KEYHANDLER3_NOP=142EAC3A
-Z(CODE)PATCH_KEYHANDLER3_CHANGE1=142EACC0
-Z(CODE)PATCH_KEYHANDLER3_CHANGE2=142EACFA

// elf file association
-Z(CODE)PATCH_DB1=144DD108-144DD10F
-Z(CODE)PATCH_DB2=144DCD14-144DCD1B
-Z(CODE)PATCH_DB3=14F1C270-14F1C277
-Z(CODE)PATCH_DB4=144251A4-144251AB

// lists initialization
// initialization of KbdHookList, Helper, Daemons
-Z(CODE)PATCH_AUTO_RUN=15B24FD8-15B24FDB
-Z(CODE)PATCH_AUTO_RUN1=15B24FDC-15B24FDF

//OseHook
-Z(CODE)PATCH_MMI_MESSAGE_HOOK=101359A4-101359AB

// PageActionHook
-Z(CODE)PATCH_PageActionImpl_All=14026E1C-14026E23
-Z(CODE)PATCH_PageActionImpl_EnterExit=14027088-1402708F

//elfpackdata
-Z(CODE)EPD=4BB00BBC-4BB00BBF
