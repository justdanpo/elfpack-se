-carm
//W890_R1FA035
-Z(CODE)START,CODE,DATA_C,INITTAB=12214000-12224000

-Z(CODE)PATCH_SWI=100F2A64-100F2A6C

-Z(CODE)LIB=12210000-12213FFF

//OseHook
-Z(CODE)PATCH_MMI_MESSAGE_HOOK=10779144-1077914B

// change keyhandler
-Z(CODE)PATCH_KEYHANDLER1=116DA7DC-116DA7E3
-Z(CODE)PATCH_KEYHANDLER2=116DAC20-116DAC27
-Z(CODE)PATCH_KEYHANDLER3=116DAD58-116DAD5F
-Z(CODE)PATCH_KEYHANDLER1_STACK1=116DA6CE
-Z(CODE)PATCH_KEYHANDLER1_STACK2=116DA8DC
-Z(CODE)PATCH_KEYHANDLER1_CHANGE1=116DA826
-Z(CODE)PATCH_KEYHANDLER1_CHANGE2=116DA866
-Z(CODE)PATCH_KEYHANDLER1_CHANGE3=116DA898
-Z(CODE)PATCH_KEYHANDLER1_CHANGE4=116DA8D2

// инициализация списков
// инициализация KbdHookList, Helper, Daemons
-Z(CODE)PATCH_AUTO_RUN=11BBBCFC-11BBBCFF
-Z(CODE)PATCH_AUTO_RUN1=11BBBD00-11BBBD03

// ассоциация elf
-Z(CODE)PATCH_DB1=11046138-1104613F
-Z(CODE)PATCH_DB2=11046184-1104618B
-Z(CODE)PATCH_DB3=110461B8-110461BF
-Z(CODE)PATCH_DB4=1104632C-11046333
-Z(CODE)PATCH_DB5=11045FF8-11045FFF
-Z(CODE)PATCH_DB6=11046B08-11046B0F

// PageActionHook
-Z(CODE)PATCH_PageActionImpl_All=11645148-1164514F
-Z(CODE)PATCH_PageActionImpl_EnterExit=116457E0-116457E7

//elfpackdata
-Z(CODE)EPD=2A257744-2A257747
