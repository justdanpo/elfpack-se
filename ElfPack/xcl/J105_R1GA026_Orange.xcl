-carm
//J105_R1GA026_Orange
-Z(CODE)START,CODE,DATA_C,INITTAB=15D00000-15D0FFFF

-Z(CODE)PATCH_SWI=101E53B0-101E53B7
-Z(CODE)LIB=15CFC000-15CFFFFF

// change keyhandler
-Z(CODE)PATCH_KEYHANDLER1=142EABA0-142EABA7
-Z(CODE)PATCH_KEYHANDLER2=144630C8-144630CF
-Z(CODE)PATCH_KEYHANDLER3=142EA758-142EA75F
-Z(CODE)PATCH_KEYHANDLER3_NOP=142EA786
-Z(CODE)PATCH_KEYHANDLER3_CHANGE1=142EA80C
-Z(CODE)PATCH_KEYHANDLER3_CHANGE2=142EA846

// elf file association
-Z(CODE)PATCH_DB1=144DBAAC-144DBAB3
-Z(CODE)PATCH_DB2=144DB6B8-144DB6BF
-Z(CODE)PATCH_DB3=14F57360-14F57367
-Z(CODE)PATCH_DB4=14423C54-14423C5B

// lists initialization
// initialization of KbdHookList, Helper, Daemons
-Z(CODE)PATCH_AUTO_RUN=15B69850-15B69853
-Z(CODE)PATCH_AUTO_RUN1=15B69854-15B69857

//OseHook
-Z(CODE)PATCH_MMI_MESSAGE_HOOK=101330C4-101330CB

// PageActionHook
-Z(CODE)PATCH_PageActionImpl_All=14026A64-14026A6B
-Z(CODE)PATCH_PageActionImpl_EnterExit=14026CD0-14026CD7

//elfpackdata
-Z(CODE)EPD=4BB057F8-4BB057FB
