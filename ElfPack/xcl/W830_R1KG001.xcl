-carm
//W830_R1KG001
-Z(CODE)START,CODE,DATA_C,INITTAB=45CE7000-45CEFFFF

-Z(CODE)PATCH_SWI=4430AF30-4430AF37
-Z(CODE)LIB=45CF0000-45CF3FFF

// change keyhandler
-Z(CODE)PATCH_KEYHANDLER1=45333240-45333247
-Z(CODE)PATCH_KEYHANDLER2=45333674-4533367B
-Z(CODE)PATCH_KEYHANDLER3=45333790-45333797
-Z(CODE)PATCH_KEYHANDLER1_STACK1=4533314A
-Z(CODE)PATCH_KEYHANDLER1_STACK2=4533332A
-Z(CODE)PATCH_KEYHANDLER1_CHANGE1=45333286
-Z(CODE)PATCH_KEYHANDLER1_CHANGE2=453332C2
-Z(CODE)PATCH_KEYHANDLER1_CHANGE3=453332F4
-Z(CODE)PATCH_KEYHANDLER1_CHANGE4=45333324

// elf file association
-Z(CODE)PATCH_DB1=44EA4C0C-44EA4C13
-Z(CODE)PATCH_DB2=44EA49F8-44EA49FF
-Z(CODE)PATCH_DB3=44EA4874-44EA487B
-Z(CODE)PATCH_DB4=44EA5264-44EA526B

// lists initialization
// initialization of KbdHookList, Helper, Daemons
-Z(CODE)PATCH_AUTO_RUN=45AFF378-45AFF37B
-Z(CODE)PATCH_AUTO_RUN1=45AFF37C-45AFF37F

//OseHook
-Z(CODE)PATCH_MMI_MESSAGE_HOOK=447A7D18-447A7D1F

// PageActionHook
-Z(CODE)PATCH_PageActionImpl_All=4528A41C-4528A423
-Z(CODE)PATCH_PageActionImpl_EnterExit=4528AE48-4528AE4F

// TabMenuBar check
-Z(CODE)PATCH_TabMenuCheck=45341ABC-45341AC3

//elfpackdata
-Z(CODE)EPD=2005A240-2005A243
