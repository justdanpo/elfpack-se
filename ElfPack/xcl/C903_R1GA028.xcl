-carm
//C903_R1GA028
-Z(CODE)START,CODE,DATA_C,INITTAB=15D8D000-15DAFFFF

-Z(CODE)PATCH_SWI=101E1640-101E1647

-Z(CODE)LIB=15D89000-15D8CFFF

//OseHook
-Z(CODE)PATCH_MMI_MESSAGE_HOOK=101369E8-101369EF

// change keyhandler
-Z(CODE)PATCH_KEYHANDLER1=14105BD8-14105BDF
-Z(CODE)PATCH_KEYHANDLER2=141062C4-141062CB
-Z(CODE)PATCH_KEYHANDLER3=14105FA0-14105FA7
-Z(CODE)PATCH_KEYHANDLER3_NOP=14105FCE
-Z(CODE)PATCH_KEYHANDLER3_CHANGE1=14106054
-Z(CODE)PATCH_KEYHANDLER3_CHANGE2=1410608E

// lists initialization
// initialization of KbdHookList, Helper, Daemons
-Z(CODE)PATCH_AUTO_RUN=15C6FA94-15C6FA97
-Z(CODE)PATCH_AUTO_RUN1=15C6FA98-15C6FA9B

// elf file association
-Z(CODE)PATCH_DB1=142DAE40-142DAE47
-Z(CODE)PATCH_DB2=142DAA48-142DAA4F
-Z(CODE)PATCH_DB3=14FCBF64-14FCBF6B
-Z(CODE)PATCH_DB4=14FA33D0-14FA33D7

// PageActionHook
-Z(CODE)PATCH_PageActionImpl_All=14103310-14103317
-Z(CODE)PATCH_PageActionImpl_EnterExit=14045540-14045547

//elfpackdata
-Z(CODE)EPD=4BB00930-4BB00933
