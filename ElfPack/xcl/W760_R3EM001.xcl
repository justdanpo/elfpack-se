-carm
//W760_R3EM001
-Z(CODE)START,CODE,DATA_C,INITTAB=12784000-1278FFFF

-Z(CODE)PATCH_SWI=1017AEF4-1017AEFB
-Z(CODE)LIB=12780000-12783FFF

// change keyhandler
-Z(CODE)PATCH_KEYHANDLER1=10A64680-10A64687
-Z(CODE)PATCH_KEYHANDLER2=10A64AD0-10A64AD7
-Z(CODE)PATCH_KEYHANDLER3=10A64C28-10A64C2F
-Z(CODE)PATCH_KEYHANDLER1_STACK1=10A64536
-Z(CODE)PATCH_KEYHANDLER1_STACK2=10A6477A
-Z(CODE)PATCH_KEYHANDLER1_CHANGE1=10A646C6
-Z(CODE)PATCH_KEYHANDLER1_CHANGE2=10A64704
-Z(CODE)PATCH_KEYHANDLER1_CHANGE3=10A64736
-Z(CODE)PATCH_KEYHANDLER1_CHANGE4=10A64770

// elf file association
-Z(CODE)PATCH_DB1=1186FA58-1186FA5F
-Z(CODE)PATCH_DB2=1186F860-1186F867
-Z(CODE)PATCH_DB3=1186F708-1186F70F
-Z(CODE)PATCH_DB4=118700D4-118700DB
-Z(CODE)PATCH_DB5=1186F8AC-1186F8B3
-Z(CODE)PATCH_DB6=1186F8E0-1186F8E7

// lists initialization
// initialization of KbdHookList, Helper, Daemons
-Z(CODE)PATCH_AUTO_RUN=11F66908-11F6690B
-Z(CODE)PATCH_AUTO_RUN1=11F6690C-11F6690F

//OseHook
-Z(CODE)PATCH_MMI_MESSAGE_HOOK=112A9B4C-112A9B53

// PageActionHook
-Z(CODE)PATCH_PageActionImpl_All=10E89194-10E8919B
-Z(CODE)PATCH_PageActionImpl_EnterExit=10E89864-10E8986B

//elfpackdata
-Z(CODE)EPD=4BB9989C-4BB9989F
